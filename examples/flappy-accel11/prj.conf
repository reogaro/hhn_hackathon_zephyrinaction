## CMakeLists.txt
```
cmake_minimum_required(VERSION 3.20.0)

# Flappy Microchip is the base of this project. Its VDMA/HDMI drivers and the
# out-of-tree devicetree bindings are reused from there rather than copied.
set(FLAPPY "${CMAKE_CURRENT_SOURCE_DIR}/../flappy-microchip/source")

# The Flappy source root contains dts/bindings/ — tell Zephyr to search it.
list(APPEND DTS_ROOT "${FLAPPY}")

find_package(Zephyr REQUIRED HINTS $ENV{ZEPHYR_BASE})

project(flappy_accel11)

set(DRIVERS "${FLAPPY}/drivers")

target_sources(app PRIVATE
    src/main.c
    src/ui.c
    src/demo_manager.c
    src/screen_hud.c
    src/screen_dashboard.c
    src/screen_charts.c
    src/screen_widgets.c
    src/microchip_logo_img.c
    src/screen_game.c
    src/accel11.c
    ${DRIVERS}/vdma_disp/vdma_disp.c
    ${DRIVERS}/hdmi_fb/hdmi_fb.c
)

# hdmi_fb.c includes vdma_disp.h — expose both driver directories
target_include_directories(app PRIVATE
    src
    ${DRIVERS}/vdma_disp
    ${DRIVERS}/hdmi_fb
)

target_link_libraries(app PRIVATE m)
```

## prj.conf
```kconfig
# Flappy Microchip controlled by an Accel 11 Click over I2C
CONFIG_SMP=y
CONFIG_MP_MAX_NUM_CPUS=4
CONFIG_SCHED_CPU_MASK=y

CONFIG_SERIAL=y
CONFIG_CONSOLE=y
CONFIG_UART_CONSOLE=y
CONFIG_PRINTK=y

CONFIG_MAIN_STACK_SIZE=2048
CONFIG_FPU_SHARING=y
CONFIG_DYNAMIC_INTERRUPTS=y

CONFIG_GPIO=y

# Accel 11 Click (BMA456) motion input, see src/accel11.c
CONFIG_I2C=y

# ── Thread introspection ────────────────────────────────────────────────────
CONFIG_THREAD_MONITOR=y
CONFIG_THREAD_NAME=y
CONFIG_THREAD_STACK_INFO=y
CONFIG_INIT_STACKS=y

# ── Zephyr shell on UART ────────────────────────────────────────────────────
CONFIG_SHELL=y
CONFIG_SHELL_BACKEND_SERIAL=y
CONFIG_KERNEL_SHELL=y

# ── Display driver ──────────────────────────────────────────────────────────
CONFIG_DISPLAY=y

# ── LVGL ────────────────────────────────────────────────────────────────────
CONFIG_LVGL=y
CONFIG_LV_Z_AUTO_INIT=y
CONFIG_LV_Z_RUN_LVGL_ON_WORKQUEUE=n
CONFIG_LV_COLOR_DEPTH_16=y
CONFIG_LV_Z_VDB_SIZE=5
CONFIG_LV_Z_BUFFER_ALLOC_STATIC=y
# 192 KB heap — complex screens + chart series data
CONFIG_LV_Z_MEM_POOL_SIZE=196608

# ── Widgets ─────────────────────────────────────────────────────────────────
CONFIG_LV_USE_LABEL=y
CONFIG_LV_USE_BAR=y
CONFIG_LV_USE_TABLE=y
CONFIG_LV_USE_ARC=y
CONFIG_LV_USE_CHART=y
CONFIG_LV_USE_BUTTON=y
CONFIG_LV_USE_SLIDER=y
CONFIG_LV_USE_SWITCH=y
CONFIG_LV_USE_CHECKBOX=y
CONFIG_LV_USE_LED=y
CONFIG_LV_USE_ROLLER=y
CONFIG_LV_USE_SCALE=y
CONFIG_LV_USE_LINE=y
CONFIG_LV_USE_SPINBOX=y
CONFIG_LV_USE_DROPDOWN=y
CONFIG_LV_USE_FLEX=y
CONFIG_LV_USE_GRID=y

# ── Fonts ───────────────────────────────────────────────────────────────────
CONFIG_LV_FONT_MONTSERRAT_14=y
CONFIG_LV_FONT_MONTSERRAT_20=y
CONFIG_LV_FONT_MONTSERRAT_32=y
CONFIG_LV_FONT_MONTSERRAT_48=y

# YUYV422 requires even-x pixel-pair alignment for all dirty regions
CONFIG_LV_Z_AREA_X_ALIGNMENT_WIDTH=2
```

## app.overlay
```dts
/*
 * app.overlay — Flappy Microchip with Accel 11 Click motion control
 *
 * Hardware nodes (VDMA, DC, HDMI framebuffer) are in the shared overlay.
 * This file adds the Zephyr SRAM region and completes the chosen node.
 *
 * SMP atomics (AMO/LR-SC on SiFive U54) require the L2 cache, so Zephyr
 * must run from cached DDR at 0x80000000, not from LIM or scratchpad.
 */

#include "../flappy-microchip/source/dts/overlays/pic64gx_display.overlay"

/ {
	cached_ram: memory@80000000 {
		compatible = "mmio-sram";
		reg = <0x80000000 0x200000>;   /* 1 MB cached DDR */
	};

	chosen {
		zephyr,sram = &cached_ram;
	};
};
```

## src/main.c
```c
/*
 * SPDX-License-Identifier: Apache-2.0
 *
 * PIC64GX Curiosity Kit — SMP + display pipeline
 * Timestamps added to every print so Zephyr time can be compared to HSS time.
 */

#include "ui.h"
#include "accel11.h"

#include <zephyr/kernel.h>
#include <zephyr/sys/printk.h>
#include <zephyr/version.h>
#include <zephyr/drivers/gpio.h>

#define TS() k_uptime_get()

/* ── LED blink ────────────────────────────────────────────────────────── */

static const struct gpio_dt_spec led0 = GPIO_DT_SPEC_GET(DT_ALIAS(led0), gpios);

static K_THREAD_STACK_DEFINE(blink_stack, 512);
static struct k_thread blink_thread;

static void blink_fn(void *p1, void *p2, void *p3)
{
	ARG_UNUSED(p1); ARG_UNUSED(p2); ARG_UNUSED(p3);

	if (!gpio_is_ready_dt(&led0)) {
		printk("[%lld] LED GPIO not ready\n", TS());
		return;
	}
	gpio_pin_configure_dt(&led0, GPIO_OUTPUT_INACTIVE);

	while (true) {
		gpio_pin_toggle_dt(&led0);
		k_sleep(K_MSEC(500));
	}
}

/* ── Per-core workers ─────────────────────────────────────────────────── */

#define WORKER_STACK  1024
#define WORKER_PRIO   5

static K_THREAD_STACK_ARRAY_DEFINE(worker_stacks, 3, WORKER_STACK);
static struct k_thread worker_threads[3];

static void core_fn(void *p1, void *p2, void *p3)
{
	ARG_UNUSED(p1); ARG_UNUSED(p2); ARG_UNUSED(p3);
	printk("[%lld] Hello from U54 core %d (hart %d)\n",
	       TS(), arch_curr_cpu()->id, arch_curr_cpu()->id + 1);
}

/* ── main ─────────────────────────────────────────────────────────────── */

int main(void)
{
	printk("[%lld] *** PIC64GX SMP bring-up ***\n", TS());
	printk("[%lld] Zephyr %s  |  %d CPUs\n\n", TS(),
	       KERNEL_VERSION_STRING, arch_num_cpus());

	k_thread_create(&blink_thread, blink_stack,
			K_THREAD_STACK_SIZEOF(blink_stack),
			blink_fn, NULL, NULL, NULL, 10, 0, K_NO_WAIT);
	k_thread_name_set(&blink_thread, "blink");

	printk("[%lld] Hello from U54 core 0 (hart 1) [main]\n", TS());

	for (int i = 0; i < 3; i++) {
		k_tid_t tid = k_thread_create(&worker_threads[i],
					      worker_stacks[i], WORKER_STACK,
					      core_fn, NULL, NULL, NULL,
					      WORKER_PRIO, 0, K_NO_WAIT);
#ifdef CONFIG_SCHED_CPU_MASK
		k_thread_cpu_mask_clear(tid);
		k_thread_cpu_mask_enable(tid, i + 1);
#else
		ARG_UNUSED(tid);
#endif
	}

	printk("[%lld] Sleeping 200ms for workers...\n", TS());
	k_sleep(K_MSEC(200));
	printk("[%lld] Awake after 200ms sleep\n", TS());

	printk("[%lld] All cores reported. LED blinking.\n\n", TS());

	accel11_start();
	ui_start();
	return 0;
}
```

## src/accel11.c
```c
/* SPDX-License-Identifier: Apache-2.0
 *
 * Accel 11 Click (Bosch BMA456) motion input for Flappy Microchip.
 *
 * A reader thread samples the accelerometer at 100 Hz and turns a sharp flick
 * of the board into a "flap" event. The game polls accel11_take_flap() from its
 * 33 ms tick and treats it like a press of SW2.
 *
 * The register access, detection and init sequence come from
 * examples/i2c-accel11. Zephyr's in-tree bma4xx driver rejects the BMA456 chip
 * ID (0x16), so the chip is driven directly through the I2C API. As there, the
 * PIC64GX I2C driver ignores the devicetree clock-frequency (i2c_configure() is
 * mandatory) and rejects zero length transfers (so presence is detected by
 * reading the chip ID).
 *
 * Flick detection is orientation independent: it looks at the size of the
 * acceleration vector, not at any one axis. At rest that is 1 g (gravity). A
 * flick pushes it well above or below 1 g for a few samples.
 */

#include "accel11.h"

#include <math.h>

#include <zephyr/kernel.h>
#include <zephyr/device.h>
#include <zephyr/drivers/i2c.h>
#include <zephyr/sys/atomic.h>
#include <zephyr/sys/printk.h>

/* ── Tuning ───────────────────────────────────────────────────────────────── */

/*
 * How far the acceleration magnitude has to move away from 1 g to count as a
 * flick. Lower is more sensitive; too low and normal handling of the board
 * flaps the player. The range is +/-2 g per axis.
 */
#define FLICK_THRESHOLD_MG   600

/*
 * Ignore further flicks for this long after one fired. A flick has a push and
 * a braking phase, both of which cross the threshold; this keeps it to one flap.
 */
#define FLICK_HOLDOFF_MS     250

#define SAMPLE_PERIOD_MS     10   /* matches the 100 Hz output data rate */

/*
 * Set to 1 to print the acceleration magnitude (in mg) every few samples. Use
 * it to see what "at rest", "handling" and "flick" look like on your board and
 * pick FLICK_THRESHOLD_MG from real numbers. Leave it 0 for normal play: the
 * console is slow (115200 baud) and printing costs time.
 */
#define ACCEL11_DEBUG_PRINT  0
#define DEBUG_PRINT_EVERY_N  5

/* ── BMA456 registers (subset) ────────────────────────────────────────────── */
#define BMA456_REG_CHIP_ID      0x00
#define BMA456_REG_ACC_X_LSB    0x12
#define BMA456_REG_ACC_CONF     0x40
#define BMA456_REG_ACC_RANGE    0x41
#define BMA456_REG_POWER_CONF   0x7C
#define BMA456_REG_POWER_CTRL   0x7D
#define BMA456_REG_CMD          0x7E

#define BMA456_CHIP_ID          0x16
#define BMA456_CMD_SOFTRESET    0xB6

/* Performance mode | normal filter, 4x averaging | ODR 100 Hz */
#define BMA456_ACC_CONF_DEFAULT 0xA8
#define BMA456_ACC_RANGE_2G     0x00
#define BMA456_POWER_CTRL_ACC_EN 0x04
#define BMA456_POWER_CONF_DEFAULT 0x00

/* 12 bit output, left aligned in a 16 bit word; +/-2 g full scale. */
#define BMA456_RAW_BITS         12
#define BMA456_RANGE_MG         2000

/* ── State shared with the game ───────────────────────────────────────────── */
static atomic_t flap_pending;
static atomic_t sensor_ready;

bool accel11_ready(void)
{
	return atomic_get(&sensor_ready) != 0;
}

bool accel11_take_flap(void)
{
	/* atomic_clear() returns the previous value, so this consumes the event. */
	return atomic_clear(&flap_pending) != 0;
}

/* ── I2C helpers ──────────────────────────────────────────────────────────── */

static const struct device *const buses[] = {
	DEVICE_DT_GET(DT_ALIAS(i2c0)),
	DEVICE_DT_GET(DT_ALIAS(i2c1)),
};

static const char *const bus_names[] = { "i2c0", "i2c1" };

/* SDO low gives 0x18 (Click default), SDO high gives 0x19. */
static const uint8_t addresses[] = { 0x18, 0x19 };

struct accel11 {
	const struct device *bus;
	uint8_t addr;
};

static int reg_read(const struct accel11 *dev, uint8_t reg, uint8_t *buf, size_t len)
{
	return i2c_write_read(dev->bus, dev->addr, &reg, 1, buf, len);
}

static int reg_write(const struct accel11 *dev, uint8_t reg, uint8_t val)
{
	const uint8_t out[2] = { reg, val };

	return i2c_write(dev->bus, out, sizeof(out), dev->addr);
}

/*
 * Which controller reaches the mikroBUS header is decided by the FPGA design,
 * so both are tried, each at both addresses.
 */
static bool detect(struct accel11 *out)
{
	for (size_t b = 0; b < ARRAY_SIZE(buses); b++) {
		if (!device_is_ready(buses[b])) {
			continue;
		}

		if (i2c_configure(buses[b],
				  I2C_SPEED_SET(I2C_SPEED_STANDARD) | I2C_MODE_CONTROLLER) != 0) {
			continue;
		}

		for (size_t a = 0; a < ARRAY_SIZE(addresses); a++) {
			struct accel11 cand = { .bus = buses[b], .addr = addresses[a] };
			uint8_t id = 0;

			if (reg_read(&cand, BMA456_REG_CHIP_ID, &id, 1) == 0 &&
			    id == BMA456_CHIP_ID) {
				printk("[accel11] BMA456 on %s at 0x%02x\n",
				       bus_names[b], addresses[a]);
				*out = cand;
				return true;
			}
		}
	}

	return false;
}

static int sensor_init(const struct accel11 *dev)
{
	int ret = reg_write(dev, BMA456_REG_CMD, BMA456_CMD_SOFTRESET);

	if (ret != 0) {
		return ret;
	}
	k_msleep(500);   /* the reference driver waits this long after a reset */

	ret = reg_write(dev, BMA456_REG_POWER_CTRL, BMA456_POWER_CTRL_ACC_EN);
	if (ret != 0) {
		return ret;
	}
	k_msleep(10);

	ret = reg_write(dev, BMA456_REG_POWER_CONF, BMA456_POWER_CONF_DEFAULT);
	if (ret != 0) {
		return ret;
	}
	k_msleep(10);

	ret = reg_write(dev, BMA456_REG_ACC_CONF, BMA456_ACC_CONF_DEFAULT);
	if (ret != 0) {
		return ret;
	}

	return reg_write(dev, BMA456_REG_ACC_RANGE, BMA456_ACC_RANGE_2G);
}

/* ── Sampling ─────────────────────────────────────────────────────────────── */

static inline int counts_to_mg(uint8_t lsb, uint8_t msb)
{
	int16_t word = (int16_t)(((uint16_t)msb << 8) | lsb);
	int16_t counts = (int16_t)(word >> (16 - BMA456_RAW_BITS));

	return ((int)counts * BMA456_RANGE_MG) >> (BMA456_RAW_BITS - 1);
}

static int read_mg(const struct accel11 *dev, int mg[3])
{
	uint8_t raw[6];
	int ret = reg_read(dev, BMA456_REG_ACC_X_LSB, raw, sizeof(raw));

	if (ret != 0) {
		return ret;
	}

	/*
	 * A dead or glitching bus tends to read as all zeros or all ones. Neither
	 * can be a real sample (at rest one axis always carries ~1 g), and both
	 * would otherwise look like a huge spike or a free fall to is_flick().
	 */
	bool all_zero = true;
	bool all_ones = true;

	for (size_t i = 0; i < sizeof(raw); i++) {
		all_zero = all_zero && raw[i] == 0x00;
		all_ones = all_ones && raw[i] == 0xFF;
	}
	if (all_zero || all_ones) {
		return -EIO;
	}

	mg[0] = counts_to_mg(raw[0], raw[1]);
	mg[1] = counts_to_mg(raw[2], raw[3]);
	mg[2] = counts_to_mg(raw[4], raw[5]);
	return 0;
}

/* Squared magnitude in mg^2. The largest possible sum is 3 * 2000^2 = 12e6,
 * which fits an int32, and comparing squares avoids a square root.
 */
static int mag2_of(const int mg[3])
{
	return mg[0] * mg[0] + mg[1] * mg[1] + mg[2] * mg[2];
}

/* Median of three: drops a single wild sample without adding any lag. */
static int median3(int a, int b, int c)
{
	if (a > b) {
		int t = a; a = b; b = t;
	}
	if (b > c) {
		b = c;
	}
	return a > b ? a : b;
}

/*
 * True when |a| is more than FLICK_THRESHOLD_MG away from 1 g. Takes the squared
 * magnitude.
 */
static bool is_flick(int mag2)
{
	const int hi = 1000 + FLICK_THRESHOLD_MG;
	const int lo = 1000 - FLICK_THRESHOLD_MG;

	return mag2 > hi * hi || mag2 < lo * lo;
}

/* ── Reader thread ────────────────────────────────────────────────────────── */

#define ACCEL_STACK 2048
#define ACCEL_PRIO  5
#define MAX_CONSECUTIVE_ERRORS 20

static K_THREAD_STACK_DEFINE(accel_stack, ACCEL_STACK);
static struct k_thread accel_thread;

static void accel_fn(void *p1, void *p2, void *p3)
{
	ARG_UNUSED(p1); ARG_UNUSED(p2); ARG_UNUSED(p3);

	struct accel11 dev;

	if (!detect(&dev)) {
		printk("[accel11] no BMA456 found, SW2 is the only input\n");
		return;
	}

	if (sensor_init(&dev) != 0) {
		printk("[accel11] init failed, SW2 is the only input\n");
		return;
	}

	atomic_set(&sensor_ready, 1);
	printk("[accel11] streaming, flick threshold %d mg\n", FLICK_THRESHOLD_MG);

	int64_t last_flap = 0;
	int errors = 0;
	int hist[3] = { 1000 * 1000, 1000 * 1000, 1000 * 1000 };  /* start at 1 g */
	unsigned int n = 0;

	while (true) {
		int mg[3];

		if (read_mg(&dev, mg) != 0) {
			if (++errors >= MAX_CONSECUTIVE_ERRORS) {
				printk("[accel11] too many read errors, stopping\n");
				break;
			}
		} else {
			errors = 0;

			/*
			 * Judge the median of the last three samples, so a flick has to
			 * show up in at least two consecutive samples (20 ms). A lone
			 * spike from an I2C glitch or a knock does not qualify.
			 */
			hist[n++ % 3] = mag2_of(mg);
			int mag2 = median3(hist[0], hist[1], hist[2]);

			if (ACCEL11_DEBUG_PRINT && n % DEBUG_PRINT_EVERY_N == 0) {
				printk("[accel11] |a| raw %d mg  median %d mg\n",
				       (int)sqrtf((float)mag2_of(mg)), (int)sqrtf((float)mag2));
			}

			int64_t now = k_uptime_get();

			if (is_flick(mag2) && now - last_flap >= FLICK_HOLDOFF_MS) {
				last_flap = now;
				atomic_set(&flap_pending, 1);
			}
		}

		k_msleep(SAMPLE_PERIOD_MS);
	}

	atomic_set(&sensor_ready, 0);
}

void accel11_start(void)
{
	k_tid_t tid = k_thread_create(&accel_thread, accel_stack,
				      K_THREAD_STACK_SIZEOF(accel_stack),
				      accel_fn, NULL, NULL, NULL,
				      ACCEL_PRIO, 0, K_NO_WAIT);

	k_thread_name_set(tid, "accel11");
}
```

## src/accel11.h
```c
/* SPDX-License-Identifier: Apache-2.0 */
#ifndef SRC_ACCEL11_H
#define SRC_ACCEL11_H

#include <stdbool.h>

/**
 * Start the Accel 11 Click (Bosch BMA456) reader thread.
 *
 * The thread probes i2c0/i2c1 for the sensor, configures it and then samples
 * at 100 Hz. If no sensor answers the thread exits and the game keeps working
 * on the SW2 button alone, so it is safe to call without a Click attached.
 */
void accel11_start(void);

/** True once the sensor has been found and is streaming. */
bool accel11_ready(void);

/**
 * Returns true once per detected flick of the board, then clears the event.
 * Meant for the game tick: OR it with the SW2 button edge.
 */
bool accel11_take_flap(void);

#endif /* SRC_ACCEL11_H */
```

## src/demo_manager.h
```c
/* SPDX-License-Identifier: Apache-2.0 */
#ifndef SRC_DEMO_MANAGER_H
#define SRC_DEMO_MANAGER_H

#include <lvgl.h>

/**
 * Screen descriptor — each demo screen registers one of these.
 */
typedef struct {
	const char  *name;
	lv_obj_t   *(*create)(void);  /* build all widgets, return screen obj */
	void        (*update)(void);  /* 1 Hz live-data refresh               */
} demo_screen_t;

/** Start the demo manager thread (pinned to core 2). */
void demo_manager_start(void);

/** Called by the FPS overlay — returns last measured render fps. */
uint32_t demo_get_render_fps(void);

/** Called by the FPS overlay — returns last measured output fps. */
uint32_t demo_get_output_fps(void);

/** Current screen index (0–3). */
int demo_get_screen_idx(void);

#endif /* SRC_DEMO_MANAGER_H */
```

## src/screen_charts.h
```c
/* SPDX-License-Identifier: Apache-2.0 */
#ifndef SRC_SCREEN_CHARTS_H
#define SRC_SCREEN_CHARTS_H

#include <lvgl.h>

lv_obj_t *screen_charts_create(void);
void      screen_charts_update(void);

#endif /* SRC_SCREEN_CHARTS_H */
```

## src/screen_dashboard.c
```c
/* SPDX-License-Identifier: Apache-2.0
 *
 * Screen 1: Vehicle Dashboard
 *
 * Shows 6 animated instruments: speed, RPM, coolant, fuel, boost, battery.
 * A scripted 12-second driving cycle drives smooth arc animations via lv_anim_t.
 */

#include "screen_dashboard.h"

#include <zephyr/kernel.h>
#include <zephyr/sys/printk.h>
#include <lvgl.h>

/* ── Colours ──────────────────────────────────────────────────────────────── */
#define C_BG     0x0D1117u
#define C_CARD   0x161B22u
#define C_BORDER 0x30363Du
#define C_ACCENT 0x58A6FFu
#define C_GREEN  0x3FB950u
#define C_YELLOW 0xD29922u
#define C_RED    0xF85149u
#define C_ORANGE 0xE06C2Bu
#define C_WHITE  0xE6EDF3u
#define C_SUBTLE 0x8B949Eu
#define C_GREY   0x484F58u

/* ── Layout ───────────────────────────────────────────────────────────────── */
#define SCR_W  1280
#define SCR_H   720
#define HDR_H    56
#define BODY_Y  (HDR_H + 4)
#define BODY_H  (SCR_H - BODY_Y - 4)
#define CELL_W  406   /* 3 columns */
#define CELL_H  (BODY_H / 2 - 4)
#define ARC_SZ  180   /* arc widget diameter */
#define BAR_W   340
#define BAR_H    18

/* ── Widget handles ───────────────────────────────────────────────────────── */
static lv_obj_t *speed_arc;
static lv_obj_t *speed_lbl;
static lv_obj_t *rpm_arc;
static lv_obj_t *rpm_lbl;
static lv_obj_t *coolant_arc;
static lv_obj_t *coolant_lbl;
static lv_obj_t *fuel_bar;
static lv_obj_t *fuel_lbl;
static lv_obj_t *boost_bar;
static lv_obj_t *boost_lbl;
static lv_obj_t *batt_bar;
static lv_obj_t *batt_lbl;
static lv_obj_t *gear_lbl;
static lv_obj_t *status_lbl;

/* ── Driving simulation state ─────────────────────────────────────────────── */
struct drive_state {
	int speed;    /* km/h */
	int rpm;      /* 1/min */
	int gear;     /* 0=N, 1-6 */
	int coolant;  /* °C */
	int fuel;     /* % */
	int boost;    /* 0-30 psi×10 */
	int battery;  /* % */
};

static struct drive_state ds = {
	.speed   = 0,
	.rpm     = 900,
	.gear    = 0,
	.coolant = 72,
	.fuel    = 85,
	.boost   = 0,
	.battery = 87,
};

/* Scripted driving sequence phases */
struct phase {
	int ticks;    /* seconds to hold this phase */
	int speed;
	int rpm;
	int gear;
	const char *status;
};

static const struct phase script[] = {
	{ 2, 0,   900,  0, "IDLE"      },
	{ 2, 30,  2800, 2, "PULL AWAY" },
	{ 2, 80,  2400, 3, "CRUISING"  },
	{ 2, 160, 4800, 4, "OVERTAKE"  },
	{ 2, 140, 3200, 5, "HIGHWAY"   },
	{ 2, 60,  1800, 3, "BRAKING"   },
};
#define N_PHASES ((int)ARRAY_SIZE(script))

static int phase_idx;
static int phase_tick;

/* ── Animate an arc to a new value ───────────────────────────────────────── */
static void arc_anim_to(lv_obj_t *arc, int32_t new_val, uint32_t dur_ms)
{
	lv_anim_t a;

	lv_anim_init(&a);
	lv_anim_set_var(&a, arc);
	lv_anim_set_exec_cb(&a, (lv_anim_exec_xcb_t)lv_arc_set_value);
	lv_anim_set_values(&a, lv_arc_get_value(arc), new_val);
	lv_anim_set_duration(&a, dur_ms);
	lv_anim_set_path_cb(&a, lv_anim_path_ease_in_out);
	lv_anim_start(&a);
}

/* ── Build helpers ────────────────────────────────────────────────────────── */
static lv_obj_t *panel(lv_obj_t *parent, int col, int row)
{
	int x = col * (CELL_W + 1);
	int y = BODY_Y + row * (CELL_H + 4);
	lv_obj_t *p = lv_obj_create(parent);

	lv_obj_set_pos(p, x, y);
	lv_obj_set_size(p, CELL_W, CELL_H);
	lv_obj_set_style_bg_color(p, lv_color_hex(C_CARD), LV_PART_MAIN);
	lv_obj_set_style_bg_opa(p, LV_OPA_COVER, LV_PART_MAIN);
	lv_obj_set_style_border_color(p, lv_color_hex(C_BORDER), LV_PART_MAIN);
	lv_obj_set_style_border_width(p, 1, LV_PART_MAIN);
	lv_obj_set_style_radius(p, 8, LV_PART_MAIN);
	lv_obj_set_style_pad_all(p, 8, LV_PART_MAIN);
	lv_obj_set_scrollbar_mode(p, LV_SCROLLBAR_MODE_OFF);
	return p;
}

static lv_obj_t *make_gauge_arc(lv_obj_t *parent,
				 int min, int max,
				 uint32_t ind_col)
{
	lv_obj_t *a = lv_arc_create(parent);

	lv_arc_set_range(a, min, max);
	lv_arc_set_value(a, min);
	lv_arc_set_bg_angles(a, 135, 45);
	lv_arc_set_mode(a, LV_ARC_MODE_NORMAL);
	lv_obj_set_size(a, ARC_SZ, ARC_SZ);
	lv_obj_align(a, LV_ALIGN_CENTER, 0, -10);

	lv_obj_set_style_arc_color(a, lv_color_hex(C_BORDER), LV_PART_MAIN);
	lv_obj_set_style_arc_width(a, 14, LV_PART_MAIN);
	lv_obj_set_style_arc_color(a, lv_color_hex(ind_col), LV_PART_INDICATOR);
	lv_obj_set_style_arc_width(a, 14, LV_PART_INDICATOR);

	/* Hide the knob */
	lv_obj_set_style_bg_opa(a, LV_OPA_TRANSP, LV_PART_KNOB);
	lv_obj_remove_flag(a, LV_OBJ_FLAG_CLICKABLE);

	return a;
}

static lv_obj_t *gauge_label(lv_obj_t *parent, const char *text,
			      uint32_t col, const lv_font_t *font)
{
	lv_obj_t *l = lv_label_create(parent);

	lv_label_set_text(l, text);
	lv_obj_set_style_text_font(l, font, LV_PART_MAIN);
	lv_obj_set_style_text_color(l, lv_color_hex(col), LV_PART_MAIN);
	lv_obj_align(l, LV_ALIGN_CENTER, 0, 28);
	return l;
}

static lv_obj_t *title_label(lv_obj_t *parent, const char *text)
{
	lv_obj_t *l = lv_label_create(parent);

	lv_label_set_text(l, text);
	lv_obj_set_style_text_font(l, &lv_font_montserrat_14, LV_PART_MAIN);
	lv_obj_set_style_text_color(l, lv_color_hex(C_SUBTLE), LV_PART_MAIN);
	lv_obj_align(l, LV_ALIGN_TOP_MID, 0, 0);
	return l;
}

static lv_obj_t *horiz_bar(lv_obj_t *parent, int min, int max, uint32_t col)
{
	lv_obj_t *b = lv_bar_create(parent);

	lv_bar_set_range(b, min, max);
	lv_bar_set_value(b, min, LV_ANIM_OFF);
	lv_obj_set_size(b, BAR_W, BAR_H);
	lv_obj_align(b, LV_ALIGN_CENTER, 0, 0);
	lv_obj_set_style_bg_color(b, lv_color_hex(C_BORDER), LV_PART_MAIN);
	lv_obj_set_style_bg_color(b, lv_color_hex(col),      LV_PART_INDICATOR);
	lv_obj_set_style_radius(b, 4, LV_PART_MAIN);
	lv_obj_set_style_radius(b, 4, LV_PART_INDICATOR);
	return b;
}

/* ── Screen construction ──────────────────────────────────────────────────── */
lv_obj_t *screen_dashboard_create(void)
{
	/* Reset state */
	phase_idx  = 0;
	phase_tick = 0;

	lv_obj_t *scr = lv_obj_create(NULL);

	lv_obj_set_style_bg_color(scr, lv_color_hex(C_BG), LV_PART_MAIN);
	lv_obj_set_style_bg_opa(scr, LV_OPA_COVER, LV_PART_MAIN);
	lv_obj_set_scrollbar_mode(scr, LV_SCROLLBAR_MODE_OFF);

	/* ── Header ─────────────────────────────────────────────────────── */
	lv_obj_t *hdr = lv_obj_create(scr);

	lv_obj_set_pos(hdr, 0, 0);
	lv_obj_set_size(hdr, SCR_W, HDR_H);
	lv_obj_set_style_bg_color(hdr, lv_color_hex(C_CARD), LV_PART_MAIN);
	lv_obj_set_style_bg_opa(hdr, LV_OPA_COVER, LV_PART_MAIN);
	lv_obj_set_style_border_width(hdr, 0, LV_PART_MAIN);
	lv_obj_set_style_radius(hdr, 0, LV_PART_MAIN);
	lv_obj_set_scrollbar_mode(hdr, LV_SCROLLBAR_MODE_OFF);

	lv_obj_t *ht = lv_label_create(hdr);

	lv_label_set_text(ht, "VEHICLE TELEMETRY");
	lv_obj_set_style_text_font(ht, &lv_font_montserrat_32, LV_PART_MAIN);
	lv_obj_set_style_text_color(ht, lv_color_white(), LV_PART_MAIN);
	lv_obj_align(ht, LV_ALIGN_LEFT_MID, 16, 0);

	/* Gear indicator — large centred digit */
	gear_lbl = lv_label_create(hdr);
	lv_label_set_text(gear_lbl, "N");
	lv_obj_set_style_text_font(gear_lbl, &lv_font_montserrat_48, LV_PART_MAIN);
	lv_obj_set_style_text_color(gear_lbl, lv_color_hex(C_GREY), LV_PART_MAIN);
	lv_obj_align(gear_lbl, LV_ALIGN_RIGHT_MID, -80, 0);

	lv_obj_t *gear_ttl = lv_label_create(hdr);

	lv_label_set_text(gear_ttl, "GEAR");
	lv_obj_set_style_text_font(gear_ttl, &lv_font_montserrat_14, LV_PART_MAIN);
	lv_obj_set_style_text_color(gear_ttl, lv_color_hex(C_SUBTLE), LV_PART_MAIN);
	lv_obj_align(gear_ttl, LV_ALIGN_RIGHT_MID, -130, -14);

	status_lbl = lv_label_create(hdr);
	lv_label_set_text(status_lbl, "IDLE");
	lv_obj_set_style_text_font(status_lbl, &lv_font_montserrat_20, LV_PART_MAIN);
	lv_obj_set_style_text_color(status_lbl, lv_color_hex(C_YELLOW), LV_PART_MAIN);
	lv_obj_align(status_lbl, LV_ALIGN_RIGHT_MID, -200, 0);

	/* Accent rule */
	lv_obj_t *rule = lv_obj_create(scr);

	lv_obj_set_pos(rule, 0, HDR_H);
	lv_obj_set_size(rule, SCR_W, 4);
	lv_obj_set_style_bg_color(rule, lv_color_hex(C_ACCENT), LV_PART_MAIN);
	lv_obj_set_style_bg_opa(rule, LV_OPA_COVER, LV_PART_MAIN);
	lv_obj_set_style_border_width(rule, 0, LV_PART_MAIN);
	lv_obj_set_style_radius(rule, 0, LV_PART_MAIN);

	/* ── Row 0, Col 0: SPEED ─────────────────────────────────────────── */
	lv_obj_t *p_speed = panel(scr, 0, 0);

	title_label(p_speed, "SPEED  km/h");
	speed_arc = make_gauge_arc(p_speed, 0, 220, C_ACCENT);
	speed_lbl = lv_label_create(p_speed);
	lv_label_set_text(speed_lbl, "0");
	lv_obj_set_style_text_font(speed_lbl, &lv_font_montserrat_48, LV_PART_MAIN);
	lv_obj_set_style_text_color(speed_lbl, lv_color_white(), LV_PART_MAIN);
	lv_obj_align(speed_lbl, LV_ALIGN_CENTER, 0, -10);

	/* ── Row 0, Col 1: RPM ───────────────────────────────────────────── */
	lv_obj_t *p_rpm = panel(scr, 1, 0);

	title_label(p_rpm, "ENGINE RPM");
	rpm_arc = make_gauge_arc(p_rpm, 0, 8000, C_ORANGE);
	rpm_lbl = gauge_label(p_rpm, "900", C_WHITE, &lv_font_montserrat_32);
	lv_obj_align(rpm_lbl, LV_ALIGN_CENTER, 0, -10);

	/* ── Row 0, Col 2: BOOST ─────────────────────────────────────────── */
	lv_obj_t *p_boost = panel(scr, 2, 0);

	title_label(p_boost, "BOOST  psi");

	lv_obj_t *bl = lv_label_create(p_boost);

	lv_label_set_text(bl, "0.0");
	lv_obj_set_style_text_font(bl, &lv_font_montserrat_48, LV_PART_MAIN);
	lv_obj_set_style_text_color(bl, lv_color_hex(C_GREEN), LV_PART_MAIN);
	lv_obj_align(bl, LV_ALIGN_CENTER, 0, -20);
	boost_lbl = bl;

	boost_bar = horiz_bar(p_boost, 0, 300, C_GREEN);
	lv_obj_align(boost_bar, LV_ALIGN_CENTER, 0, 30);
	{
		lv_obj_t *u = lv_label_create(p_boost);

		lv_label_set_text(u, "max 30 psi");
		lv_obj_set_style_text_font(u, &lv_font_montserrat_14, LV_PART_MAIN);
		lv_obj_set_style_text_color(u, lv_color_hex(C_SUBTLE), LV_PART_MAIN);
		lv_obj_align(u, LV_ALIGN_BOTTOM_MID, 0, -4);
	}

	/* ── Row 1, Col 0: COOLANT ───────────────────────────────────────── */
	lv_obj_t *p_cool = panel(scr, 0, 1);

	title_label(p_cool, "COOLANT  \xc2\xb0" "C");
	coolant_arc = make_gauge_arc(p_cool, 40, 120, C_GREEN);
	lv_arc_set_value(coolant_arc, 72);
	coolant_lbl = gauge_label(p_cool, "72\xc2\xb0", C_WHITE, &lv_font_montserrat_32);
	lv_obj_align(coolant_lbl, LV_ALIGN_CENTER, 0, -10);

	/* ── Row 1, Col 1: FUEL ──────────────────────────────────────────── */
	lv_obj_t *p_fuel = panel(scr, 1, 1);

	title_label(p_fuel, "FUEL LEVEL");

	lv_obj_t *fl = lv_label_create(p_fuel);

	lv_label_set_text(fl, "85%");
	lv_obj_set_style_text_font(fl, &lv_font_montserrat_48, LV_PART_MAIN);
	lv_obj_set_style_text_color(fl, lv_color_hex(C_GREEN), LV_PART_MAIN);
	lv_obj_align(fl, LV_ALIGN_CENTER, 0, -20);
	fuel_lbl = fl;

	fuel_bar = horiz_bar(p_fuel, 0, 100, C_GREEN);
	lv_bar_set_value(fuel_bar, 85, LV_ANIM_OFF);
	lv_obj_align(fuel_bar, LV_ALIGN_CENTER, 0, 30);

	/* ── Row 1, Col 2: BATTERY ───────────────────────────────────────── */
	lv_obj_t *p_batt = panel(scr, 2, 1);

	title_label(p_batt, "12V BATTERY");

	lv_obj_t *bt = lv_label_create(p_batt);

	lv_label_set_text(bt, "87%");
	lv_obj_set_style_text_font(bt, &lv_font_montserrat_48, LV_PART_MAIN);
	lv_obj_set_style_text_color(bt, lv_color_hex(C_ACCENT), LV_PART_MAIN);
	lv_obj_align(bt, LV_ALIGN_CENTER, 0, -20);
	batt_lbl = bt;

	batt_bar = horiz_bar(p_batt, 0, 100, C_ACCENT);
	lv_bar_set_value(batt_bar, 87, LV_ANIM_OFF);
	lv_obj_align(batt_bar, LV_ALIGN_CENTER, 0, 30);

	/* Kick off first arc animation */
	arc_anim_to(speed_arc, ds.speed, 500);
	arc_anim_to(rpm_arc, ds.rpm, 500);
	arc_anim_to(coolant_arc, ds.coolant, 500);

	return scr;
}

/* ── 1 Hz update ──────────────────────────────────────────────────────────── */
void screen_dashboard_update(void)
{
	if (!speed_arc) {
		return;
	}

	/* Advance driving script */
	const struct phase *ph = &script[phase_idx];

	phase_tick++;
	if (phase_tick >= ph->ticks) {
		phase_idx  = (phase_idx + 1) % N_PHASES;
		phase_tick = 0;
		ph = &script[phase_idx];
	}

	ds.speed  = ph->speed;
	ds.rpm    = ph->rpm;
	ds.gear   = ph->gear;
	ds.boost  = (ds.rpm > 2000) ? (ds.rpm - 2000) / 100 : 0;

	/* Coolant slowly rises to 92, then holds */
	if (ds.coolant < 92) {
		ds.coolant++;
	}

	/* Fuel drops slowly */
	if (ds.fuel > 5 && (phase_idx % 3 == 0)) {
		ds.fuel--;
	}

	/* Animate arcs */
	arc_anim_to(speed_arc, ds.speed, 900);
	arc_anim_to(rpm_arc, ds.rpm, 900);
	arc_anim_to(coolant_arc, ds.coolant, 1500);

	/* Bars */
	lv_bar_set_value(fuel_bar, ds.fuel, LV_ANIM_ON);
	lv_bar_set_value(boost_bar, ds.boost * 10, LV_ANIM_ON);
	lv_bar_set_value(batt_bar, ds.battery, LV_ANIM_OFF);

	/* Coolant indicator colour: green < 90, yellow < 100, red ≥ 100 */
	uint32_t cc = (ds.coolant >= 100) ? C_RED :
		      (ds.coolant >= 90)  ? C_YELLOW : C_GREEN;

	lv_obj_set_style_arc_color(coolant_arc, lv_color_hex(cc), LV_PART_INDICATOR);

	/* Labels */
	char buf[16];

	snprintk(buf, sizeof(buf), "%d", ds.speed);
	lv_label_set_text(speed_lbl, buf);

	snprintk(buf, sizeof(buf), "%d", ds.rpm);
	lv_label_set_text(rpm_lbl, buf);

	snprintk(buf, sizeof(buf), "%d\xc2\xb0", ds.coolant);
	lv_label_set_text(coolant_lbl, buf);

	snprintk(buf, sizeof(buf), "%d%%", ds.fuel);
	lv_label_set_text(fuel_lbl, buf);

	snprintk(buf, sizeof(buf), "%.1f", (double)ds.boost / 10.0);
	lv_label_set_text(boost_lbl, buf);

	snprintk(buf, sizeof(buf), "%d%%", ds.battery);
	lv_label_set_text(batt_lbl, buf);

	/* Gear display */
	if (ds.gear == 0) {
		lv_label_set_text(gear_lbl, "N");
		lv_obj_set_style_text_color(gear_lbl, lv_color_hex(C_GREY),
					    LV_PART_MAIN);
	} else {
		snprintk(buf, sizeof(buf), "%d", ds.gear);
		lv_label_set_text(gear_lbl, buf);
		uint32_t gc = (ds.gear <= 2) ? C_GREEN :
			      (ds.gear <= 4) ? C_YELLOW : C_ORANGE;

		lv_obj_set_style_text_color(gear_lbl, lv_color_hex(gc), LV_PART_MAIN);
	}

	lv_label_set_text(status_lbl, ph->status);
}
```

## src/screen_game.c
```c
/* SPDX-License-Identifier: Apache-2.0
 *
 * Flappy Bird mini-game for PIC64GX Curiosity Kit.
 *
 * Controls
 *   SW1 (sw0 alias, gpio2 pin 28) — enter game / return to demo (handled by demo_manager)
 *   SW2 (sw2 node,  gpio2 pin 6 ) — flap / start
 *   Flick the board (Accel 11 Click, see accel11.c) — same as SW2
 *
 * Player sprite: 44×44 Microchip red rounded rectangle with bold white "M" label.
 * Physics driven by a 33 ms lv_timer_t (runs within lv_timer_handler on the UI thread).
 * Timer is deleted via LV_EVENT_DELETE on the screen object.
 *
 * State machine: WAIT → PLAY → OVER → (done flag → demo_manager returns to HUD)
 */

#include "screen_game.h"

#include <zephyr/kernel.h>
#include <zephyr/drivers/gpio.h>
#include <zephyr/sys/printk.h>
#include <lvgl.h>
#include "microchip_logo_img.h"
#include "accel11.h"

/* ── GPIO buttons ─────────────────────────────────────────────────────────── */
static const struct gpio_dt_spec btn_flap =
	GPIO_DT_SPEC_GET(DT_NODELABEL(sw2), gpios);
static const struct gpio_dt_spec btn_enter =
	GPIO_DT_SPEC_GET(DT_ALIAS(sw0), gpios);

/* ── Colours ──────────────────────────────────────────────────────────────── */
#define C_SKY      0x0D1117u
#define C_GROUND   0x3D2B1Fu
#define C_GROUND_H 0x6B4423u
#define C_PIPE     0x3FB950u
#define C_PIPE_CAP 0x2D8A3Au
#define C_MC_RED   0xC0392Bu
#define C_WHITE    0xE6EDF3u
#define C_YELLOW   0xD29922u
#define C_SUBTLE   0x8B949Eu
#define C_OVERLAY  0x161B22u

/* ── Physics constants ────────────────────────────────────────────────────── */
#define GRAVITY     0.50f
#define FLAP_VEL  -11.00f
#define VEL_MAX    14.00f
#define SCROLL_SPD  4.00f   /* initial scroll speed */
#define SPEED_STEP  0.35f   /* added per passed pipe */
#define SPEED_MAX  12.00f   /* speed cap */

/* ── Layout constants ─────────────────────────────────────────────────────── */
#define SCR_W        1280
#define SCR_H         720
#define PLAYER_X      160
#define PLAYER_SZ      44
#define PIPE_W         80
#define PIPE_CAP_H     18
#define GAP_H         280   /* larger gap = easier for kids */
#define PIPE_SPACING  430
#define N_PIPES         3
#define GROUND_Y      672
#define GROUND_H       48
#define GAP_MIN       (GAP_H / 2 + 50)
#define GAP_MAX       (GROUND_Y - GAP_H / 2 - 50)
#define N_STARS        20

/* A flick right after a crash is usually the player still moving, not asking
 * for a restart, so flicks are ignored for this long after GAME_OVER. */
#define OVER_FLICK_HOLDOFF_MS 1000

/* ── Game state ───────────────────────────────────────────────────────────── */
typedef enum { GAME_WAIT, GAME_PLAY, GAME_OVER } game_state_t;

static game_state_t state;
static float        py;         /* player Y (top of sprite) */
static float        vy;         /* player vertical velocity */
static float        pipe_x[N_PIPES];
static int          gap_cy[N_PIPES]; /* centre Y of pipe gap */
static int          score;
static int          best_score;
static float        scroll_spd;   /* current scroll speed, ramps up per pipe */
static bool         scored[N_PIPES]; /* has this pipe been passed */
static int64_t      over_time_ms;    /* when GAME_OVER was entered */
static bool         game_done;       /* signals demo_manager to return */

/* ── Button edge detection ────────────────────────────────────────────────── */
static int prev_flap_state;
static int prev_enter_state;
static bool btn_inited;

static void btn_init_once(void)
{
	if (btn_inited) {
		return;
	}
	if (gpio_is_ready_dt(&btn_flap)) {
		gpio_pin_configure_dt(&btn_flap, GPIO_INPUT);
	}
	if (gpio_is_ready_dt(&btn_enter)) {
		gpio_pin_configure_dt(&btn_enter, GPIO_INPUT);
	}
	/* Seed previous states to current (avoid spurious edge on first call) */
	prev_flap_state  = gpio_pin_get_dt(&btn_flap);
	prev_enter_state = gpio_pin_get_dt(&btn_enter);
	btn_inited = true;
}

static bool flap_edge(void)
{
	int cur = gpio_pin_get_dt(&btn_flap);
	bool edge = (cur == 1) && (prev_flap_state == 0);

	prev_flap_state = cur;
	return edge;
}

static bool enter_edge(void)
{
	int cur = gpio_pin_get_dt(&btn_enter);
	bool edge = (cur == 1) && (prev_enter_state == 0);

	prev_enter_state = cur;
	return edge;
}

/* ── LVGL widget handles ──────────────────────────────────────────────────── */
static lv_obj_t *player_obj;
static lv_obj_t *pipe_top_body[N_PIPES];
static lv_obj_t *pipe_top_cap[N_PIPES];
static lv_obj_t *pipe_bot_body[N_PIPES];
static lv_obj_t *pipe_bot_cap[N_PIPES];
static lv_obj_t *score_lbl;
static lv_obj_t *status_panel;
static lv_obj_t *status_lbl;
static lv_obj_t *sub_lbl;
static lv_timer_t *game_timer;

/* ── Random number (xorshift) ─────────────────────────────────────────────── */
static uint32_t rng_state = 0xDEADBEEFu;

static int rand_gap_cy(void)
{
	rng_state ^= rng_state << 13;
	rng_state ^= rng_state >> 17;
	rng_state ^= rng_state << 5;
	return GAP_MIN + (int)(rng_state % (uint32_t)(GAP_MAX - GAP_MIN));
}

/* ── Pipe helpers ─────────────────────────────────────────────────────────── */
static void pipe_reset(int i, float x)
{
	pipe_x[i]   = x;
	gap_cy[i]   = rand_gap_cy();
	scored[i]   = false;
}

/* Find the pipe furthest to the right */
static float pipes_rightmost_x(void)
{
	float mx = pipe_x[0];

	for (int i = 1; i < N_PIPES; i++) {
		if (pipe_x[i] > mx) {
			mx = pipe_x[i];
		}
	}
	return mx;
}

static void pipe_update_objs(int i)
{
	int ix = (int)pipe_x[i];
	int top_h = gap_cy[i] - GAP_H / 2;
	int bot_y = gap_cy[i] + GAP_H / 2;
	int bot_h = GROUND_Y - bot_y;

	if (top_h < 0) {
		top_h = 0;
	}
	if (bot_h < 0) {
		bot_h = 0;
	}

	/* Top pipe body */
	lv_obj_set_pos(pipe_top_body[i], ix, 0);
	lv_obj_set_size(pipe_top_body[i], PIPE_W, (top_h > PIPE_CAP_H) ?
			top_h - PIPE_CAP_H : 0);

	/* Top pipe cap (wider, at the bottom of the top pipe) */
	lv_obj_set_pos(pipe_top_cap[i], ix - 5, top_h - PIPE_CAP_H);
	lv_obj_set_size(pipe_top_cap[i], PIPE_W + 10,
			(top_h > 0) ? PIPE_CAP_H : 0);

	/* Bottom pipe body */
	lv_obj_set_pos(pipe_bot_body[i], ix, bot_y + PIPE_CAP_H);
	lv_obj_set_size(pipe_bot_body[i], PIPE_W,
			(bot_h > PIPE_CAP_H) ? bot_h - PIPE_CAP_H : 0);

	/* Bottom pipe cap (wider, at the top of the bottom pipe) */
	lv_obj_set_pos(pipe_bot_cap[i], ix - 5, bot_y);
	lv_obj_set_size(pipe_bot_cap[i], PIPE_W + 10,
			(bot_h > 0) ? PIPE_CAP_H : 0);
}

/* ── Collision (AABB) ─────────────────────────────────────────────────────── */
static bool rects_overlap(int ax1, int ay1, int ax2, int ay2,
			   int bx1, int by1, int bx2, int by2)
{
	return ax1 < bx2 && ax2 > bx1 && ay1 < by2 && ay2 > by1;
}

static bool check_collision(void)
{
	int px1 = PLAYER_X + 4;  /* shrink hitbox slightly for fairness */
	int py1 = (int)py + 4;
	int px2 = PLAYER_X + PLAYER_SZ - 4;
	int py2 = (int)py + PLAYER_SZ - 4;

	/* Ground / ceiling */
	if (py2 >= GROUND_Y || py1 <= 0) {
		return true;
	}

	for (int i = 0; i < N_PIPES; i++) {
		int ix = (int)pipe_x[i];
		int top_h = gap_cy[i] - GAP_H / 2;
		int bot_y = gap_cy[i] + GAP_H / 2;

		/* Top pipe */
		if (rects_overlap(px1, py1, px2, py2,
				  ix, 0, ix + PIPE_W, top_h)) {
			return true;
		}
		/* Bottom pipe */
		if (rects_overlap(px1, py1, px2, py2,
				  ix, bot_y, ix + PIPE_W, GROUND_Y)) {
			return true;
		}
	}
	return false;
}

/* ── Status overlay helpers ───────────────────────────────────────────────── */
static void status_show(const char *main_text, const char *sub_text)
{
	lv_obj_clear_flag(status_panel, LV_OBJ_FLAG_HIDDEN);
	lv_label_set_text(status_lbl, main_text);
	lv_label_set_text(sub_lbl, sub_text ? sub_text : "");
}

static void status_hide(void)
{
	lv_obj_add_flag(status_panel, LV_OBJ_FLAG_HIDDEN);
}

static void score_update(void)
{
	char buf[16];

	snprintk(buf, sizeof(buf), "%d", score);
	lv_label_set_text(score_lbl, buf);
}

/* ── Game state transitions ───────────────────────────────────────────────── */
static void game_reset(void)
{
	py    = 300.0f;
	vy    = 0.0f;
	score = 0;
	scroll_spd = SCROLL_SPD;

	for (int i = 0; i < N_PIPES; i++) {
		pipe_reset(i, (float)(SCR_W + i * PIPE_SPACING));
		pipe_update_objs(i);
	}

	score_update();
	lv_obj_set_pos(player_obj, PLAYER_X, (int)py);
}

static void enter_wait(void)
{
	state = GAME_WAIT;
	game_reset();
	status_show("FLAPPY MICROCHIP",
		    "Flick the board or press SW2 to start");
	lv_obj_set_style_text_color(status_lbl, lv_color_hex(C_MC_RED),
				    LV_PART_MAIN);
}

static void enter_play(void)
{
	state = GAME_PLAY;
	status_hide();
}

static void enter_over(void)
{
	char buf[64];

	state = GAME_OVER;
	over_time_ms = k_uptime_get();

	if (score > best_score) {
		best_score = score;
	}

	snprintk(buf, sizeof(buf), "GAME OVER    %d pts", score);
	if (score > 0 && score == best_score) {
		lv_label_set_text(sub_lbl, "New best!");
		lv_obj_set_style_text_color(sub_lbl, lv_color_hex(C_YELLOW),
					    LV_PART_MAIN);
	} else {
		char sub[32];

		snprintk(sub, sizeof(sub), "Best: %d   flick to retry", best_score);
		lv_label_set_text(sub_lbl, sub);
		lv_obj_set_style_text_color(sub_lbl, lv_color_hex(C_SUBTLE),
					    LV_PART_MAIN);
	}
	lv_obj_clear_flag(status_panel, LV_OBJ_FLAG_HIDDEN);
	lv_label_set_text(status_lbl, buf);
	lv_obj_set_style_text_color(status_lbl, lv_color_hex(C_WHITE),
				    LV_PART_MAIN);
}

/* ── 33 ms physics tick (LVGL timer, runs on UI thread) ──────────────────── */
static void game_tick_cb(lv_timer_t *t)
{
	ARG_UNUSED(t);

	btn_init_once();

	/* Always consume the flick so a stale one never fires later. */
	bool flick = accel11_take_flap();
	bool flap  = flap_edge();
	bool enter = enter_edge();

	if (state == GAME_OVER &&
	    k_uptime_get() - over_time_ms < OVER_FLICK_HOLDOFF_MS) {
		flick = false;
	}
	flap = flap || flick;

	switch (state) {
	case GAME_WAIT:
		if (flap) {
			enter_play();
		}
		/* Gentle hover animation while waiting */
		vy += 0.1f;
		py += vy;
		if (py > 320.0f || py < 280.0f) {
			vy = -vy * 0.8f;
			py = CLAMP(py, 280.0f, 320.0f);
		}
		lv_obj_set_pos(player_obj, PLAYER_X, (int)py);
		break;

	case GAME_PLAY:
		/* Physics */
		vy += GRAVITY;
		if (vy > VEL_MAX) {
			vy = VEL_MAX;
		}
		if (flap) {
			vy = FLAP_VEL;
		}
		py += vy;

		lv_obj_set_pos(player_obj, PLAYER_X, (int)py);

		/* Scroll pipes */
		for (int i = 0; i < N_PIPES; i++) {
			pipe_x[i] -= scroll_spd;

			/* Score: player passed pipe centre */
			int centre = (int)pipe_x[i] + PIPE_W / 2;

			if (!scored[i] && centre < PLAYER_X) {
				scored[i] = true;
				score++;
				score_update();
				/* Speed up a little after each pipe, up to the cap */
				scroll_spd += SPEED_STEP;
				if (scroll_spd > SPEED_MAX) {
					scroll_spd = SPEED_MAX;
				}
			}

			/* Respawn pipe that has exited left */
			if (pipe_x[i] + PIPE_W < 0) {
				pipe_reset(i, pipes_rightmost_x() + PIPE_SPACING);
			}

			pipe_update_objs(i);
		}

		/* Collision */
		if (check_collision()) {
			enter_over();
		}
		break;

	case GAME_OVER:
		/* SW2 (flap) restarts the game IN PLACE — same screen, same
		 * timer. No screen reload, so no timer-clobbering race. */
		if (flap) {
			enter_wait();
		}
		break;
	}
}

/* ── Screen delete cleanup ────────────────────────────────────────────────── */
static void game_screen_delete_cb(lv_event_t *e)
{
	ARG_UNUSED(e);

	if (game_timer) {
		lv_timer_delete(game_timer);
		game_timer = NULL;
	}
	/* Null all widget handles so stale pointers are never dereferenced */
	player_obj = NULL;
	score_lbl  = NULL;
	status_panel = NULL;
	status_lbl = NULL;
	sub_lbl    = NULL;
	for (int i = 0; i < N_PIPES; i++) {
		pipe_top_body[i] = NULL;
		pipe_top_cap[i]  = NULL;
		pipe_bot_body[i] = NULL;
		pipe_bot_cap[i]  = NULL;
	}
}

/* ── Screen construction ──────────────────────────────────────────────────── */
lv_obj_t *screen_game_create(void)
{
	game_done        = false;
	if (gpio_is_ready_dt(&btn_flap)) {
		gpio_pin_configure_dt(&btn_flap, GPIO_INPUT);
	}
	if (gpio_is_ready_dt(&btn_enter)) {
		gpio_pin_configure_dt(&btn_enter, GPIO_INPUT);
	}
	prev_flap_state  = gpio_pin_get_dt(&btn_flap);
	prev_enter_state = gpio_pin_get_dt(&btn_enter);
	btn_inited       = true;

	lv_obj_t *scr = lv_obj_create(NULL);

	lv_obj_set_style_bg_color(scr, lv_color_hex(C_SKY), LV_PART_MAIN);
	lv_obj_set_style_bg_opa(scr, LV_OPA_COVER, LV_PART_MAIN);
	lv_obj_set_scrollbar_mode(scr, LV_SCROLLBAR_MODE_OFF);

	/* ── Stars (static decorative dots) ─────────────────────────────── */
	uint32_t star_rng = 0xCAFEBABEu;

	for (int i = 0; i < N_STARS; i++) {
		star_rng ^= star_rng << 13;
		star_rng ^= star_rng >> 17;
		star_rng ^= star_rng << 5;
		int sx = (int)(star_rng % (uint32_t)SCR_W);

		star_rng ^= star_rng << 13;
		star_rng ^= star_rng >> 17;
		star_rng ^= star_rng << 5;
		int sy = (int)(star_rng % (uint32_t)(GROUND_Y - 20));

		lv_obj_t *star = lv_obj_create(scr);
		int sz = (i % 3 == 0) ? 4 : 3;

		lv_obj_set_pos(star, sx, sy);
		lv_obj_set_size(star, sz, sz);
		lv_obj_set_style_bg_color(star, lv_color_white(), LV_PART_MAIN);
		lv_obj_set_style_bg_opa(star, LV_OPA_60, LV_PART_MAIN);
		lv_obj_set_style_border_width(star, 0, LV_PART_MAIN);
		lv_obj_set_style_radius(star, LV_RADIUS_CIRCLE, LV_PART_MAIN);
	}

	/* ── Ground ──────────────────────────────────────────────────────── */
	lv_obj_t *ground = lv_obj_create(scr);

	lv_obj_set_pos(ground, 0, GROUND_Y);
	lv_obj_set_size(ground, SCR_W, GROUND_H);
	lv_obj_set_style_bg_color(ground, lv_color_hex(C_GROUND), LV_PART_MAIN);
	lv_obj_set_style_bg_opa(ground, LV_OPA_COVER, LV_PART_MAIN);
	lv_obj_set_style_border_width(ground, 0, LV_PART_MAIN);
	lv_obj_set_style_radius(ground, 0, LV_PART_MAIN);

	/* Ground highlight strip */
	lv_obj_t *gh = lv_obj_create(scr);

	lv_obj_set_pos(gh, 0, GROUND_Y);
	lv_obj_set_size(gh, SCR_W, 4);
	lv_obj_set_style_bg_color(gh, lv_color_hex(C_GROUND_H), LV_PART_MAIN);
	lv_obj_set_style_bg_opa(gh, LV_OPA_COVER, LV_PART_MAIN);
	lv_obj_set_style_border_width(gh, 0, LV_PART_MAIN);
	lv_obj_set_style_radius(gh, 0, LV_PART_MAIN);

	/* ── Pipes (pre-created, positioned in game_reset) ───────────────── */
	for (int i = 0; i < N_PIPES; i++) {
		/* Top body */
		pipe_top_body[i] = lv_obj_create(scr);
		lv_obj_set_style_bg_color(pipe_top_body[i], lv_color_hex(C_PIPE),
					   LV_PART_MAIN);
		lv_obj_set_style_bg_opa(pipe_top_body[i], LV_OPA_COVER, LV_PART_MAIN);
		lv_obj_set_style_border_width(pipe_top_body[i], 0, LV_PART_MAIN);
		lv_obj_set_style_radius(pipe_top_body[i], 0, LV_PART_MAIN);

		/* Top cap */
		pipe_top_cap[i] = lv_obj_create(scr);
		lv_obj_set_style_bg_color(pipe_top_cap[i], lv_color_hex(C_PIPE_CAP),
					   LV_PART_MAIN);
		lv_obj_set_style_bg_opa(pipe_top_cap[i], LV_OPA_COVER, LV_PART_MAIN);
		lv_obj_set_style_border_width(pipe_top_cap[i], 0, LV_PART_MAIN);
		lv_obj_set_style_radius(pipe_top_cap[i], 3, LV_PART_MAIN);

		/* Bottom body */
		pipe_bot_body[i] = lv_obj_create(scr);
		lv_obj_set_style_bg_color(pipe_bot_body[i], lv_color_hex(C_PIPE),
					   LV_PART_MAIN);
		lv_obj_set_style_bg_opa(pipe_bot_body[i], LV_OPA_COVER, LV_PART_MAIN);
		lv_obj_set_style_border_width(pipe_bot_body[i], 0, LV_PART_MAIN);
		lv_obj_set_style_radius(pipe_bot_body[i], 0, LV_PART_MAIN);

		/* Bottom cap */
		pipe_bot_cap[i] = lv_obj_create(scr);
		lv_obj_set_style_bg_color(pipe_bot_cap[i], lv_color_hex(C_PIPE_CAP),
					   LV_PART_MAIN);
		lv_obj_set_style_bg_opa(pipe_bot_cap[i], LV_OPA_COVER, LV_PART_MAIN);
		lv_obj_set_style_border_width(pipe_bot_cap[i], 0, LV_PART_MAIN);
		lv_obj_set_style_radius(pipe_bot_cap[i], 3, LV_PART_MAIN);
	}

	/* ── Player: Microchip logo (red rounded rect + white M) ─────────── */
	/* ── Player: Microchip logo (RGB565, rounded corners) ───────────── */
	player_obj = lv_image_create(scr);
	lv_image_set_src(player_obj, &microchip_logo_img);
	lv_obj_set_style_bg_opa(player_obj, LV_OPA_TRANSP, 0);
	lv_obj_set_style_border_width(player_obj, 0, 0);
	lv_obj_set_style_pad_all(player_obj, 0, 0);

	/* ── Score label ─────────────────────────────────────────────────── */
	score_lbl = lv_label_create(scr);
	lv_label_set_text(score_lbl, "0");
	lv_obj_set_style_text_font(score_lbl, &lv_font_montserrat_48, LV_PART_MAIN);
	lv_obj_set_style_text_color(score_lbl, lv_color_white(), LV_PART_MAIN);
	lv_obj_align(score_lbl, LV_ALIGN_TOP_MID, 0, 12);

	/* ── Status overlay (hidden during play) ─────────────────────────── */
	status_panel = lv_obj_create(scr);
	lv_obj_set_size(status_panel, 700, 150);
	lv_obj_align(status_panel, LV_ALIGN_CENTER, 0, 0);
	lv_obj_set_style_bg_color(status_panel, lv_color_hex(C_OVERLAY), LV_PART_MAIN);
	lv_obj_set_style_bg_opa(status_panel, LV_OPA_80, LV_PART_MAIN);
	lv_obj_set_style_border_color(status_panel, lv_color_hex(C_MC_RED),
				       LV_PART_MAIN);
	lv_obj_set_style_border_width(status_panel, 2, LV_PART_MAIN);
	lv_obj_set_style_radius(status_panel, 10, LV_PART_MAIN);
	lv_obj_set_scrollbar_mode(status_panel, LV_SCROLLBAR_MODE_OFF);

	status_lbl = lv_label_create(status_panel);
	lv_label_set_text(status_lbl, "");
	lv_obj_set_style_text_font(status_lbl, &lv_font_montserrat_32, LV_PART_MAIN);
	lv_obj_set_style_text_color(status_lbl, lv_color_white(), LV_PART_MAIN);
	lv_obj_align(status_lbl, LV_ALIGN_CENTER, 0, -22);

	sub_lbl = lv_label_create(status_panel);
	lv_label_set_text(sub_lbl, "");
	lv_obj_set_style_text_font(sub_lbl, &lv_font_montserrat_20, LV_PART_MAIN);
	lv_obj_set_style_text_color(sub_lbl, lv_color_hex(C_SUBTLE), LV_PART_MAIN);
	lv_obj_align(sub_lbl, LV_ALIGN_CENTER, 0, 20);

	/* ── Initialise game to WAIT state ───────────────────────────────── */
	enter_wait();

	/* ── Game timer: 33 ms physics loop ─────────────────────────────── */
	game_timer = lv_timer_create(game_tick_cb, 33, NULL);

	/* ── Cleanup hook: delete timer when screen is freed ─────────────── */
	lv_obj_add_event_cb(scr, game_screen_delete_cb, LV_EVENT_DELETE, NULL);

	return scr;
}

void screen_game_update(void)
{
	/* Physics is driven by game_timer; nothing to do at 1 Hz. */
}

bool screen_game_is_done(void)
{
	if (game_done) {
		game_done = false;
		return true;
	}
	return false;
}
```

## src/screen_game.h
```c
/* SPDX-License-Identifier: Apache-2.0 */
#ifndef SRC_SCREEN_GAME_H
#define SRC_SCREEN_GAME_H

#include <lvgl.h>

/** Build the game screen and return it (does not load it). */
lv_obj_t *screen_game_create(void);

/** 1 Hz placeholder — game is self-updating via its own lv_timer_t. */
void screen_game_update(void);

/**
 * Returns true once: when the player has finished GAME_OVER (3 s hold or
 * SW1 press).  Resets the flag on return so it only fires once per session.
 * demo_manager polls this to know when to fade back to the HUD.
 */
bool screen_game_is_done(void);

#endif /* SRC_SCREEN_GAME_H */
```

## src/screen_hud.h
```c
/* SPDX-License-Identifier: Apache-2.0 */
#ifndef SRC_SCREEN_HUD_H
#define SRC_SCREEN_HUD_H

#include <lvgl.h>

lv_obj_t *screen_hud_create(void);
void      screen_hud_update(void);

#endif /* SRC_SCREEN_HUD_H */
```

## src/ui.c
```c
/* SPDX-License-Identifier: Apache-2.0
 *
 * Entry point called from main.c — delegates to the demo manager.
 */

#include "ui.h"
#include "demo_manager.h"

void ui_start(void)
{
	demo_manager_start();
}
```

## src/ui.h
```c
/* SPDX-License-Identifier: Apache-2.0 */
#ifndef SRC_UI_H
#define SRC_UI_H

/** Start the LVGL UI thread, pinned to core 2. */
void ui_start(void);

#endif /* SRC_UI_H */
```
