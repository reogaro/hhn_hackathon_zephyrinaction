## CMakeLists.txt
```
cmake_minimum_required(VERSION 3.20.0)

# Flappy Microchip is the base of this project. Its VDMA/HDMI drivers and the
# out-of-tree devicetree bindings are reused from there rather than copied.
set(FLAPPY "${CMAKE_CURRENT_SOURCE_DIR}/../flappy-microchip/source")

# The Flappy source root contains dts/bindings/ — tell Zephyr to search it.
list(APPEND DTS_ROOT "${FLAPPY}")

find_package(Zephyr REQUIRED HINTS $ENV{ZEPHYR_BASE})

project(flappy_gy521)

set(DRIVERS "${FLAPPY}/drivers")

target_sources(app PRIVATE
    src/main.c
    src/ui.c
    src/demo_manager.c
    src/screen_hud.c
    src/screen_dashboard.c
    src/screen_charts.c
    src/screen_widgets.c
    src/microchip_logo_img.c
    src/screen_game.c
    src/gy521.c
    ${DRIVERS}/vdma_disp/vdma_disp.c
    ${DRIVERS}/hdmi_fb/hdmi_fb.c
)

# hdmi_fb.c includes vdma_disp.h — expose both driver directories
target_include_directories(app PRIVATE
    src
    ${DRIVERS}/vdma_disp
    ${DRIVERS}/hdmi_fb
)

target_link_libraries(app PRIVATE m)
```

## prj.conf
```kconfig
# Flappy Microchip controlled by a GY-521 (MPU-6050) IMU over I2C
CONFIG_SMP=y
CONFIG_MP_MAX_NUM_CPUS=4
CONFIG_SCHED_CPU_MASK=y

CONFIG_SERIAL=y
CONFIG_CONSOLE=y
CONFIG_UART_CONSOLE=y
CONFIG_PRINTK=y

CONFIG_MAIN_STACK_SIZE=2048
CONFIG_FPU_SHARING=y
CONFIG_DYNAMIC_INTERRUPTS=y

CONFIG_GPIO=y

# GY-521 (MPU-6050) motion input, see src/gy521.c
CONFIG_I2C=y

# ── Thread introspection ────────────────────────────────────────────────────
CONFIG_THREAD_MONITOR=y
CONFIG_THREAD_NAME=y
CONFIG_THREAD_STACK_INFO=y
CONFIG_INIT_STACKS=y

# ── Zephyr shell on UART ────────────────────────────────────────────────────
CONFIG_SHELL=y
CONFIG_SHELL_BACKEND_SERIAL=y
CONFIG_KERNEL_SHELL=y

# ── Display driver ──────────────────────────────────────────────────────────
CONFIG_DISPLAY=y

# ── LVGL ────────────────────────────────────────────────────────────────────
CONFIG_LVGL=y
CONFIG_LV_Z_AUTO_INIT=y
CONFIG_LV_Z_RUN_LVGL_ON_WORKQUEUE=n
CONFIG_LV_COLOR_DEPTH_16=y
CONFIG_LV_Z_VDB_SIZE=5
CONFIG_LV_Z_BUFFER_ALLOC_STATIC=y
# 192 KB heap — complex screens + chart series data
CONFIG_LV_Z_MEM_POOL_SIZE=196608

# ── Widgets ─────────────────────────────────────────────────────────────────
CONFIG_LV_USE_LABEL=y
CONFIG_LV_USE_BAR=y
CONFIG_LV_USE_TABLE=y
CONFIG_LV_USE_ARC=y
CONFIG_LV_USE_CHART=y
CONFIG_LV_USE_BUTTON=y
CONFIG_LV_USE_SLIDER=y
CONFIG_LV_USE_SWITCH=y
CONFIG_LV_USE_CHECKBOX=y
CONFIG_LV_USE_LED=y
CONFIG_LV_USE_ROLLER=y
CONFIG_LV_USE_SCALE=y
CONFIG_LV_USE_LINE=y
CONFIG_LV_USE_SPINBOX=y
CONFIG_LV_USE_DROPDOWN=y
CONFIG_LV_USE_FLEX=y
CONFIG_LV_USE_GRID=y

# ── Fonts ───────────────────────────────────────────────────────────────────
CONFIG_LV_FONT_MONTSERRAT_14=y
CONFIG_LV_FONT_MONTSERRAT_20=y
CONFIG_LV_FONT_MONTSERRAT_32=y
CONFIG_LV_FONT_MONTSERRAT_48=y

# YUYV422 requires even-x pixel-pair alignment for all dirty regions
CONFIG_LV_Z_AREA_X_ALIGNMENT_WIDTH=2
```

## app.overlay
```dts
/*
 * app.overlay — Flappy Microchip with GY-521 (MPU-6050) motion control
 *
 * Hardware nodes (VDMA, DC, HDMI framebuffer) are in the shared overlay.
 * This file adds the Zephyr SRAM region and completes the chosen node.
 *
 * SMP atomics (AMO/LR-SC on SiFive U54) require the L2 cache, so Zephyr
 * must run from cached DDR at 0x80000000, not from LIM or scratchpad.
 */

#include "../flappy-microchip/source/dts/overlays/pic64gx_display.overlay"

/ {
	cached_ram: memory@80000000 {
		compatible = "mmio-sram";
		reg = <0x80000000 0x200000>;   /* 1 MB cached DDR */
	};

	chosen {
		zephyr,sram = &cached_ram;
	};
};
```

## src/main.c
```c
/*
 * SPDX-License-Identifier: Apache-2.0
 *
 * PIC64GX Curiosity Kit — SMP + display pipeline
 * Timestamps added to every print so Zephyr time can be compared to HSS time.
 */

#include "ui.h"
#include "gy521.h"

#include <zephyr/kernel.h>
#include <zephyr/sys/printk.h>
#include <zephyr/version.h>
#include <zephyr/drivers/gpio.h>

#define TS() k_uptime_get()

/* ── LED blink ────────────────────────────────────────────────────────── */

static const struct gpio_dt_spec led0 = GPIO_DT_SPEC_GET(DT_ALIAS(led0), gpios);

static K_THREAD_STACK_DEFINE(blink_stack, 512);
static struct k_thread blink_thread;

static void blink_fn(void *p1, void *p2, void *p3)
{
	ARG_UNUSED(p1); ARG_UNUSED(p2); ARG_UNUSED(p3);

	if (!gpio_is_ready_dt(&led0)) {
		printk("[%lld] LED GPIO not ready\n", TS());
		return;
	}
	gpio_pin_configure_dt(&led0, GPIO_OUTPUT_INACTIVE);

	while (true) {
		gpio_pin_toggle_dt(&led0);
		k_sleep(K_MSEC(500));
	}
}

/* ── Per-core workers ─────────────────────────────────────────────────── */

#define WORKER_STACK  1024
#define WORKER_PRIO   5

static K_THREAD_STACK_ARRAY_DEFINE(worker_stacks, 3, WORKER_STACK);
static struct k_thread worker_threads[3];

static void core_fn(void *p1, void *p2, void *p3)
{
	ARG_UNUSED(p1); ARG_UNUSED(p2); ARG_UNUSED(p3);
	printk("[%lld] Hello from U54 core %d (hart %d)\n",
	       TS(), arch_curr_cpu()->id, arch_curr_cpu()->id + 1);
}

/* ── main ─────────────────────────────────────────────────────────────── */

int main(void)
{
	printk("[%lld] *** PIC64GX SMP bring-up ***\n", TS());
	printk("[%lld] Zephyr %s  |  %d CPUs\n\n", TS(),
	       KERNEL_VERSION_STRING, arch_num_cpus());

	k_thread_create(&blink_thread, blink_stack,
			K_THREAD_STACK_SIZEOF(blink_stack),
			blink_fn, NULL, NULL, NULL, 10, 0, K_NO_WAIT);
	k_thread_name_set(&blink_thread, "blink");

	printk("[%lld] Hello from U54 core 0 (hart 1) [main]\n", TS());

	for (int i = 0; i < 3; i++) {
		k_tid_t tid = k_thread_create(&worker_threads[i],
					      worker_stacks[i], WORKER_STACK,
					      core_fn, NULL, NULL, NULL,
					      WORKER_PRIO, 0, K_NO_WAIT);
#ifdef CONFIG_SCHED_CPU_MASK
		k_thread_cpu_mask_clear(tid);
		k_thread_cpu_mask_enable(tid, i + 1);
#else
		ARG_UNUSED(tid);
#endif
	}

	printk("[%lld] Sleeping 200ms for workers...\n", TS());
	k_sleep(K_MSEC(200));
	printk("[%lld] Awake after 200ms sleep\n", TS());

	printk("[%lld] All cores reported. LED blinking.\n\n", TS());

	gy521_start();
	ui_start();
	return 0;
}
```

## src/demo_manager.c
```c
/* SPDX-License-Identifier: Apache-2.0
 *
 * Demo manager — orchestrates 4-screen cycling demo on PIC64GX.
 *
 * Runs on core 2 (K_FOREVER + k_thread_start pattern).
 * Screens cycle every CYCLE_MS ms with a 400 ms fade transition.
 * A persistent overlay on lv_layer_top() shows render/output FPS
 * and screen indicator dots.
 *
 * SW1 (sw0 alias) — at any time: enter Flappy Bird game mode.
 * Game screen self-manages; demo_manager polls screen_game_is_done()
 * to know when to return to the normal cycle.
 */

#include "demo_manager.h"
#include "screen_hud.h"
#include "screen_dashboard.h"
#include "screen_charts.h"
#include "screen_widgets.h"
#include "screen_game.h"

#include <zephyr/kernel.h>
#include <zephyr/drivers/gpio.h>
#include <zephyr/sys/printk.h>
#include "vdma_disp.h"

/* ── Colour palette (shared) ──────────────────────────────────────────────── */
#define C_BG     0x0D1117u
#define C_GREEN  0x3FB950u
#define C_SUBTLE 0x8B949Eu
#define C_WHITE  0xE6EDF3u
#define C_ACCENT 0x58A6FFu
#define C_MC_RED 0xC0392Bu

/* ── Timing ───────────────────────────────────────────────────────────────── */
#define CYCLE_MS   5000   /* screen hold time in ms */
#define RENDER_MS    33   /* lv_timer_handler period (~30 fps) */
#define FADE_MS     400   /* transition fade duration */

/* ── Screen table ─────────────────────────────────────────────────────────── */
static const demo_screen_t screens[] = {
	{ "STATS HUD",      screen_hud_create,       screen_hud_update       },
	{ "DASHBOARD",      screen_dashboard_create, screen_dashboard_update  },
	{ "LIVE TELEMETRY", screen_charts_create,    screen_charts_update     },
	{ "WIDGET GALLERY", screen_widgets_create,   screen_widgets_update    },
};
#define N_SCREENS ((int)ARRAY_SIZE(screens))

static int      cur_screen = -1;   /* -1 = not yet initialised */
static lv_obj_t *active_scr;
static bool     in_game_mode;

/* ── Game mode entry button (SW1 = sw0 alias) ─────────────────────────────── */
static const struct gpio_dt_spec btn_game =
	GPIO_DT_SPEC_GET(DT_ALIAS(sw0), gpios);
static int prev_game_btn;
static bool game_btn_inited;

static void game_btn_init(void)
{
	if (gpio_is_ready_dt(&btn_game)) {
		gpio_pin_configure_dt(&btn_game, GPIO_INPUT);
		prev_game_btn = gpio_pin_get_dt(&btn_game);
	}
	game_btn_inited = true;
}

/* Returns true on rising edge of SW1 (pressed = pin goes high due to ACTIVE_LOW flag) */
static bool game_btn_edge(void)
{
	if (!game_btn_inited) {
		return false;
	}
	int cur = gpio_pin_get_dt(&btn_game);
	bool edge = (cur == 1) && (prev_game_btn == 0);

	prev_game_btn = cur;
	return edge;
}

/* ── FPS state ────────────────────────────────────────────────────────────── */
static uint32_t g_render_fps;
static uint32_t g_output_fps;

uint32_t demo_get_render_fps(void) { return g_render_fps; }
uint32_t demo_get_output_fps(void) { return g_output_fps; }
int      demo_get_screen_idx(void) { return cur_screen; }

/* ── Persistent overlay (lv_layer_top()) ─────────────────────────────────── */
static lv_obj_t *fps_badge;
static lv_obj_t *dot_bar;
static lv_obj_t *game_hint;

static void overlay_create(void)
{
	lv_obj_t *top = lv_layer_top();

	/* Top-right FPS badge */
	fps_badge = lv_label_create(top);
	lv_label_set_text(fps_badge, "R:-- D:--fps");
	lv_obj_set_style_text_font(fps_badge, &lv_font_montserrat_14, LV_PART_MAIN);
	lv_obj_set_style_text_color(fps_badge, lv_color_hex(C_GREEN), LV_PART_MAIN);
	lv_obj_align(fps_badge, LV_ALIGN_TOP_RIGHT, -12, 6);

	/* Bottom-center screen indicator dots */
	dot_bar = lv_label_create(top);
	lv_label_set_text(dot_bar, "\xe2\x97\x8f  \xe2\x97\x8b  \xe2\x97\x8b  \xe2\x97\x8b");
	lv_obj_set_style_text_font(dot_bar, &lv_font_montserrat_14, LV_PART_MAIN);
	lv_obj_set_style_text_color(dot_bar, lv_color_hex(C_WHITE), LV_PART_MAIN);
	lv_obj_align(dot_bar, LV_ALIGN_BOTTOM_MID, 0, -6);

	/* Top-left game hint */
	game_hint = lv_label_create(top);
	lv_label_set_text(game_hint, "SW1: GAME");
	lv_obj_set_style_text_font(game_hint, &lv_font_montserrat_14, LV_PART_MAIN);
	lv_obj_set_style_text_color(game_hint, lv_color_hex(C_MC_RED), LV_PART_MAIN);
	lv_obj_align(game_hint, LV_ALIGN_TOP_LEFT, 12, 6);
}

static void overlay_update(uint32_t render_fps, uint32_t output_fps, int idx)
{
	char buf[32];

	snprintk(buf, sizeof(buf), "R:%u D:%ufps", render_fps, output_fps);
	lv_label_set_text(fps_badge, buf);

	if (in_game_mode) {
		lv_label_set_text(dot_bar, "\xe2\x96\xb6 GAME");
		lv_obj_set_style_text_color(dot_bar, lv_color_hex(C_MC_RED),
					    LV_PART_MAIN);
		lv_label_set_text(game_hint, "SW1: EXIT");
		return;
	}

	lv_obj_set_style_text_color(dot_bar, lv_color_hex(C_WHITE), LV_PART_MAIN);
	lv_label_set_text(game_hint, "SW1: GAME");

	/* Build dot string: filled circle for current, empty for others */
	static const char *filled = "\xe2\x97\x8f";
	static const char *empty  = "\xe2\x97\x8b";
	char dots[64];
	int  pos = 0;

	for (int i = 0; i < N_SCREENS; i++) {
		const char *sym = (i == idx) ? filled : empty;

		while (*sym) {
			dots[pos++] = *sym++;
		}
		if (i < N_SCREENS - 1) {
			dots[pos++] = ' ';
			dots[pos++] = ' ';
		}
	}
	dots[pos] = '\0';
	lv_label_set_text(dot_bar, dots);
}

/* ── Screen switching ─────────────────────────────────────────────────────── */
static void load_screen(int idx)
{
	lv_obj_t *new_scr = screens[idx].create();

	if (cur_screen < 0) {
		/* First load — no animation, no old screen to delete */
		lv_screen_load(new_scr);
	} else {
		lv_screen_load_anim(new_scr, LV_SCR_LOAD_ANIM_FADE_ON,
				    FADE_MS, 0, true);
	}
	active_scr = new_scr;
	cur_screen = idx;
	printk("[demo] screen %d: %s\n", idx, screens[idx].name);
}

static void load_game_screen(void)
{
	lv_obj_t *game_scr = screen_game_create();

	lv_screen_load_anim(game_scr, LV_SCR_LOAD_ANIM_FADE_ON, FADE_MS, 0, true);
	active_scr = game_scr;
	printk("[demo] game mode\n");
}

/* ── Demo worker threads (make thread table interesting) ──────────────────── */
#define DW_STACK  512
#define DW_COUNT  4

static K_THREAD_STACK_ARRAY_DEFINE(dw_stacks, DW_COUNT, DW_STACK);
static struct k_thread dw_threads[DW_COUNT];

static void demo_worker_fn(void *p1, void *p2, void *p3)
{
	ARG_UNUSED(p2); ARG_UNUSED(p3);
	uint32_t phase = (uint32_t)(uintptr_t)p1;
	uint32_t x = 0xACE1u + phase * 0x1234u;

	while (true) {
		for (int i = 0; i < 50000; i++) {
			x ^= x << 13;
			x ^= x >> 17;
			x ^= x << 5;
		}
		k_sleep(K_MSEC(100 + (phase * 73) % 200));
	}
}

static void demo_workers_start(void)
{
	static const char *names[] = { "demo_w0", "demo_w1", "demo_w2", "demo_w3" };

	for (int i = 0; i < DW_COUNT; i++) {
		k_tid_t tid = k_thread_create(&dw_threads[i],
					      dw_stacks[i], DW_STACK,
					      demo_worker_fn,
					      (void *)(uintptr_t)i,
					      NULL, NULL,
					      8 + i, 0, K_FOREVER);
#ifdef CONFIG_SCHED_CPU_MASK
		k_thread_cpu_mask_clear(tid);
		k_thread_cpu_mask_enable(tid, 1 + (i % 3));
#endif
		k_thread_name_set(tid, names[i]);
		k_thread_start(tid);
	}
}

/* ── Main demo thread ─────────────────────────────────────────────────────── */
#define DM_STACK  16384
#define DM_PRIO   6
#define DM_CORE   2

static K_THREAD_STACK_DEFINE(dm_stack, DM_STACK);
static struct k_thread dm_thread;

static void demo_thread_fn(void *p1, void *p2, void *p3)
{
	ARG_UNUSED(p1); ARG_UNUSED(p2); ARG_UNUSED(p3);

	printk("[demo] starting on core %d\n", arch_curr_cpu()->id);

	game_btn_init();

	/* Build persistent overlay first (before any screen) */
	overlay_create();

	/* Start directly in Flappy Bird */
	in_game_mode = true;
	load_game_screen();

	int64_t next_stat   = k_uptime_get() + 1000;
	int64_t next_switch = k_uptime_get() + CYCLE_MS;
	uint32_t render_ticks = 0;

	while (true) {
		int64_t now = k_uptime_get();

		/* ── SW1 edge: enter or exit game mode ─────────────────────── */
		if (game_btn_edge()) {
			if (!in_game_mode) {
				in_game_mode = true;
				load_game_screen();
				/* Reset cycle so demo resumes cleanly on exit */
				next_switch = now + CYCLE_MS;
			}
			/* If in_game_mode, screen_game handles SW1 internally
			 * (it returns to demo via screen_game_is_done() below). */
		}

		/* ── Poll game-done flag → return to HUD ───────────────────── */
		/* Game restarts itself in place (screen_game GAME_OVER handles SW2).
		 * We never leave game mode, so no reload logic is needed here. */

		/* ── 1 Hz: update screen data + refresh overlay ────────────── */
		if (now >= next_stat) {
			if (!in_game_mode) {
				screens[cur_screen].update();
			} else {
				screen_game_update();
			}

			g_render_fps = render_ticks;
			g_output_fps = vdma_disp_get_frame_count(
				DEVICE_DT_GET(DT_NODELABEL(vdma_disp)));
			overlay_update(g_render_fps, g_output_fps, cur_screen);

			render_ticks = 0;
			next_stat = now + 1000;
		}

		/* ── 5 s: advance to next screen (suppressed in game mode) ─── */
		if (!in_game_mode && now >= next_switch) {
			int next = (cur_screen + 1) % N_SCREENS;

			load_screen(next);
			next_switch = now + CYCLE_MS;
		}

		lv_timer_handler();
		render_ticks++;
		k_sleep(K_MSEC(RENDER_MS));
	}
}

void demo_manager_start(void)
{
	demo_workers_start();

	k_tid_t tid = k_thread_create(&dm_thread, dm_stack, DM_STACK,
				      demo_thread_fn, NULL, NULL, NULL,
				      DM_PRIO, 0, K_FOREVER);
#ifdef CONFIG_SCHED_CPU_MASK
	k_thread_cpu_mask_clear(tid);
	k_thread_cpu_mask_enable(tid, DM_CORE);
#endif
	k_thread_name_set(tid, "demo_mgr");
	k_thread_start(tid);

	printk("[demo] manager thread started (core %d)\n", DM_CORE);
}
```

## src/gy521.c
```c
/* SPDX-License-Identifier: Apache-2.0
 *
 * GY-521 (InvenSense MPU-6050) motion input for Flappy Microchip.
 *
 * A reader thread samples the accelerometer and gyroscope at 100 Hz and turns a
 * sharp flick or twist of the board into a "flap" event. The game polls
 * gy521_take_flap() from its 33 ms tick and treats it like a press of SW2.
 *
 * The register map, detection and init sequence come from examples/i2c-gy521.
 * As there, the PIC64GX I2C driver ignores the devicetree clock-frequency
 * (i2c_configure() is mandatory) and rejects zero length transfers (so presence
 * is detected by reading WHO_AM_I).
 *
 * Both detectors are orientation independent, they look at the size of a vector
 * and not at any one axis:
 *
 *   flick  the acceleration vector. At rest it is 1 g (gravity). A linear flick
 *          pushes it well above or below 1 g for a few samples.
 *   twist  the angular rate vector. At rest it is ~0 dps. Turning the board
 *          quickly, like a wrist flick, pushes it well above that.
 *
 * Either one raises a flap, so the player can use whichever motion feels right.
 */

#include "gy521.h"

#include <math.h>

#include <zephyr/kernel.h>
#include <zephyr/device.h>
#include <zephyr/drivers/i2c.h>
#include <zephyr/sys/atomic.h>
#include <zephyr/sys/printk.h>

/* ── Tuning ───────────────────────────────────────────────────────────────── */

/*
 * How far the acceleration magnitude has to move away from 1 g to count as a
 * flick. Lower is more sensitive; too low and normal handling of the board
 * flaps the player. The range is +/-2 g per axis.
 */
#define FLICK_THRESHOLD_MG   600

/*
 * How fast the board has to turn to count as a twist. The range is +/-250 dps
 * per axis, so the largest useful value is a bit under 430 dps (all three axes
 * saturated).
 */
#define TWIST_THRESHOLD_DPS  150

/*
 * Ignore further motion for this long after a flap fired. A flick has a push and
 * a braking phase, both of which cross the threshold; this keeps it to one flap.
 */
#define FLAP_HOLDOFF_MS      250

#define SAMPLE_PERIOD_MS     10   /* matches the 100 Hz output data rate */

/*
 * Set to 1 to print the acceleration magnitude (mg) and angular rate (dps) every
 * few samples. Use it to see what "at rest", "handling" and "flap" look like on
 * your board and pick the thresholds from real numbers. Leave it 0 for normal
 * play: the console is slow (115200 baud) and printing costs time.
 */
#define GY521_DEBUG_PRINT    0
#define DEBUG_PRINT_EVERY_N  5

/* ── MPU-6050 registers (subset) ──────────────────────────────────────────── */
#define MPU6050_REG_SMPLRT_DIV   0x19
#define MPU6050_REG_CONFIG       0x1A
#define MPU6050_REG_GYRO_CONFIG  0x1B
#define MPU6050_REG_ACCEL_CONFIG 0x1C
#define MPU6050_REG_ACCEL_XOUT_H 0x3B
#define MPU6050_REG_PWR_MGMT_1   0x6B
#define MPU6050_REG_WHO_AM_I     0x75

#define MPU6050_WHO_AM_I_VAL     0x68

#define MPU6050_PWR1_DEVICE_RESET   0x80
#define MPU6050_PWR1_CLK_PLL_XGYRO  0x01

#define MPU6050_DLPF_44HZ        0x03
#define MPU6050_SMPLRT_DIV_200HZ 0x04   /* 1 kHz / (1 + 4); sampled at 100 Hz */
#define MPU6050_GYRO_FS_250DPS   0x00
#define MPU6050_ACCEL_FS_2G      0x00

/* +/-2 g -> 16384 LSB/g, +/-250 dps -> 131.072 LSB/dps */
#define MPU6050_ACCEL_LSB_PER_G  16384
#define MPU6050_GYRO_LSB_PER_DPS 131

/* ── State shared with the game ───────────────────────────────────────────── */
static atomic_t flap_pending;
static atomic_t sensor_ready;

bool gy521_ready(void)
{
	return atomic_get(&sensor_ready) != 0;
}

bool gy521_take_flap(void)
{
	/* atomic_clear() returns the previous value, so this consumes the event. */
	return atomic_clear(&flap_pending) != 0;
}

/* ── I2C helpers ──────────────────────────────────────────────────────────── */

static const struct device *const buses[] = {
	DEVICE_DT_GET(DT_ALIAS(i2c0)),
	DEVICE_DT_GET(DT_ALIAS(i2c1)),
};

static const char *const bus_names[] = { "i2c0", "i2c1" };

/* AD0 low gives 0x68 (GY-521 default pull-down), AD0 high gives 0x69. */
static const uint8_t addresses[] = { 0x68, 0x69 };

struct gy521 {
	const struct device *bus;
	uint8_t addr;
};

static int reg_read(const struct gy521 *dev, uint8_t reg, uint8_t *buf, size_t len)
{
	return i2c_write_read(dev->bus, dev->addr, &reg, 1, buf, len);
}

static int reg_write(const struct gy521 *dev, uint8_t reg, uint8_t val)
{
	const uint8_t out[2] = { reg, val };

	return i2c_write(dev->bus, out, sizeof(out), dev->addr);
}

/* The bus can be busy right after a reset, so writes are retried a few times. */
static int reg_write_retry(const struct gy521 *dev, uint8_t reg, uint8_t val)
{
	int ret = -EIO;

	for (int i = 0; i < 5; i++) {
		ret = reg_write(dev, reg, val);
		if (ret == 0) {
			return 0;
		}
		k_msleep(20);
	}
	return ret;
}

/*
 * Which controller reaches the header is decided by the FPGA design, so both are
 * tried, each at both addresses.
 */
static bool detect(struct gy521 *out)
{
	for (size_t b = 0; b < ARRAY_SIZE(buses); b++) {
		if (!device_is_ready(buses[b])) {
			continue;
		}

		if (i2c_configure(buses[b],
				  I2C_SPEED_SET(I2C_SPEED_STANDARD) | I2C_MODE_CONTROLLER) != 0) {
			continue;
		}

		for (size_t a = 0; a < ARRAY_SIZE(addresses); a++) {
			struct gy521 cand = { .bus = buses[b], .addr = addresses[a] };
			uint8_t id = 0;

			/* Bit 0 and bit 7 are not part of the ID on some clones. */
			if (reg_read(&cand, MPU6050_REG_WHO_AM_I, &id, 1) == 0 &&
			    (id & 0x7E) == MPU6050_WHO_AM_I_VAL) {
				printk("[gy521] MPU-6050 on %s at 0x%02x (WHO_AM_I 0x%02x)\n",
				       bus_names[b], addresses[a], id);
				*out = cand;
				return true;
			}
		}
	}

	return false;
}

static int sensor_init(const struct gy521 *dev)
{
	int ret;

	k_msleep(50);

	ret = reg_write_retry(dev, MPU6050_REG_PWR_MGMT_1, MPU6050_PWR1_DEVICE_RESET);
	if (ret != 0) {
		return ret;
	}
	k_msleep(100);

	/* Wake up and take the PLL clock referenced to the X gyro. */
	ret = reg_write_retry(dev, MPU6050_REG_PWR_MGMT_1, MPU6050_PWR1_CLK_PLL_XGYRO);
	if (ret != 0) {
		return ret;
	}
	k_msleep(20);

	ret = reg_write_retry(dev, MPU6050_REG_CONFIG, MPU6050_DLPF_44HZ);
	if (ret != 0) {
		return ret;
	}

	ret = reg_write_retry(dev, MPU6050_REG_SMPLRT_DIV, MPU6050_SMPLRT_DIV_200HZ);
	if (ret != 0) {
		return ret;
	}

	ret = reg_write_retry(dev, MPU6050_REG_GYRO_CONFIG, MPU6050_GYRO_FS_250DPS);
	if (ret != 0) {
		return ret;
	}

	return reg_write_retry(dev, MPU6050_REG_ACCEL_CONFIG, MPU6050_ACCEL_FS_2G);
}

/* ── Sampling ─────────────────────────────────────────────────────────────── */

static inline int16_t be16(const uint8_t *p)
{
	return (int16_t)(((uint16_t)p[0] << 8) | p[1]);
}

/* One burst read: accel X/Y/Z, temperature, gyro X/Y/Z (14 bytes, big endian). */
static int read_sample(const struct gy521 *dev, int accel_mg[3], int gyro_dps[3])
{
	uint8_t raw[14];
	int ret = reg_read(dev, MPU6050_REG_ACCEL_XOUT_H, raw, sizeof(raw));

	if (ret != 0) {
		return ret;
	}

	/*
	 * A dead or glitching bus tends to read as all zeros or all ones. Neither
	 * can be a real sample (at rest one accel axis always carries ~1 g), and both
	 * would otherwise look like a spike or a free fall to the detectors.
	 */
	bool all_zero = true;
	bool all_ones = true;

	for (size_t i = 0; i < sizeof(raw); i++) {
		all_zero = all_zero && raw[i] == 0x00;
		all_ones = all_ones && raw[i] == 0xFF;
	}
	if (all_zero || all_ones) {
		return -EIO;
	}

	for (int i = 0; i < 3; i++) {
		accel_mg[i] = ((int)be16(&raw[2 * i]) * 1000) / MPU6050_ACCEL_LSB_PER_G;
		gyro_dps[i] = (int)be16(&raw[8 + 2 * i]) / MPU6050_GYRO_LSB_PER_DPS;
	}
	return 0;
}

/*
 * Squared magnitude. The largest possible accel sum is 3 * 2000^2 = 12e6 (mg^2),
 * the largest gyro sum 3 * 250^2 = 187500 (dps^2), both well inside an int32, and
 * comparing squares avoids a square root.
 */
static int mag2_of(const int v[3])
{
	return v[0] * v[0] + v[1] * v[1] + v[2] * v[2];
}

/* Median of three: drops a single wild sample without adding any lag. */
static int median3(int a, int b, int c)
{
	if (a > b) {
		int t = a; a = b; b = t;
	}
	if (b > c) {
		b = c;
	}
	return a > b ? a : b;
}

/* True when |a| is more than FLICK_THRESHOLD_MG away from 1 g (squared input). */
static bool is_flick(int accel_mag2)
{
	const int hi = 1000 + FLICK_THRESHOLD_MG;
	const int lo = 1000 - FLICK_THRESHOLD_MG;

	return accel_mag2 > hi * hi || accel_mag2 < lo * lo;
}

/* True when the board turns faster than TWIST_THRESHOLD_DPS (squared input). */
static bool is_twist(int gyro_mag2)
{
	return gyro_mag2 > TWIST_THRESHOLD_DPS * TWIST_THRESHOLD_DPS;
}

/* ── Reader thread ────────────────────────────────────────────────────────── */

#define GY521_STACK 2048
#define GY521_PRIO  5
#define MAX_CONSECUTIVE_ERRORS 20

static K_THREAD_STACK_DEFINE(gy521_stack, GY521_STACK);
static struct k_thread gy521_thread;

static void gy521_fn(void *p1, void *p2, void *p3)
{
	ARG_UNUSED(p1); ARG_UNUSED(p2); ARG_UNUSED(p3);

	struct gy521 dev;

	if (!detect(&dev)) {
		printk("[gy521] no MPU-6050 found, SW2 is the only input\n");
		return;
	}

	if (sensor_init(&dev) != 0) {
		printk("[gy521] init failed, SW2 is the only input\n");
		return;
	}

	atomic_set(&sensor_ready, 1);
	printk("[gy521] streaming, flick threshold %d mg, twist threshold %d dps\n",
	       FLICK_THRESHOLD_MG, TWIST_THRESHOLD_DPS);

	int64_t last_flap = 0;
	int errors = 0;
	int accel_hist[3] = { 1000 * 1000, 1000 * 1000, 1000 * 1000 };  /* start at 1 g */
	int gyro_hist[3] = { 0, 0, 0 };                                 /* start at rest */
	unsigned int n = 0;

	while (true) {
		int accel_mg[3];
		int gyro_dps[3];

		if (read_sample(&dev, accel_mg, gyro_dps) != 0) {
			if (++errors >= MAX_CONSECUTIVE_ERRORS) {
				printk("[gy521] too many read errors, stopping\n");
				break;
			}
		} else {
			errors = 0;

			/*
			 * Judge the median of the last three samples, so a motion has to
			 * show up in at least two consecutive samples (20 ms). A lone
			 * spike from an I2C glitch or a knock does not qualify.
			 */
			accel_hist[n % 3] = mag2_of(accel_mg);
			gyro_hist[n % 3] = mag2_of(gyro_dps);
			n++;

			int accel_mag2 = median3(accel_hist[0], accel_hist[1], accel_hist[2]);
			int gyro_mag2 = median3(gyro_hist[0], gyro_hist[1], gyro_hist[2]);

			if (GY521_DEBUG_PRINT && n % DEBUG_PRINT_EVERY_N == 0) {
				printk("[gy521] |a| %d mg  |w| %d dps (median)\n",
				       (int)sqrtf((float)accel_mag2),
				       (int)sqrtf((float)gyro_mag2));
			}

			int64_t now = k_uptime_get();

			if ((is_flick(accel_mag2) || is_twist(gyro_mag2)) &&
			    now - last_flap >= FLAP_HOLDOFF_MS) {
				last_flap = now;
				atomic_set(&flap_pending, 1);
			}
		}

		k_msleep(SAMPLE_PERIOD_MS);
	}

	atomic_set(&sensor_ready, 0);
}

void gy521_start(void)
{
	k_tid_t tid = k_thread_create(&gy521_thread, gy521_stack,
				      K_THREAD_STACK_SIZEOF(gy521_stack),
				      gy521_fn, NULL, NULL, NULL,
				      GY521_PRIO, 0, K_NO_WAIT);

	k_thread_name_set(tid, "gy521");
}
```

## src/gy521.h
```c
/* SPDX-License-Identifier: Apache-2.0 */
#ifndef SRC_GY521_H
#define SRC_GY521_H

#include <stdbool.h>

/**
 * Start the GY-521 (InvenSense MPU-6050) reader thread.
 *
 * The thread probes i2c0/i2c1 for the sensor, configures it and then samples
 * the accelerometer and gyroscope at 100 Hz. If no sensor answers the thread
 * exits and the game keeps working on the SW2 button alone, so it is safe to
 * call without a GY-521 attached.
 */
void gy521_start(void);

/** True once the sensor has been found and is streaming. */
bool gy521_ready(void);

/**
 * Returns true once per detected flick or twist of the board, then clears the
 * event. Meant for the game tick: OR it with the SW2 button edge.
 */
bool gy521_take_flap(void);

#endif /* SRC_GY521_H */
```

## src/microchip_logo_img.h
```c
/* SPDX-License-Identifier: Apache-2.0 — auto-generated */
#ifndef MICROCHIP_LOGO_IMG_H
#define MICROCHIP_LOGO_IMG_H
#include <lvgl.h>
extern const lv_image_dsc_t microchip_logo_img;
#endif
```

## src/screen_game.c
```c
/* SPDX-License-Identifier: Apache-2.0
 *
 * Flappy Bird mini-game for PIC64GX Curiosity Kit.
 *
 * Controls
 *   SW1 (sw0 alias, gpio2 pin 28) — enter game / return to demo (handled by demo_manager)
 *   SW2 (sw2 node,  gpio2 pin 6 ) — flap / start
 *   Flick or twist the board (GY-521 IMU, see gy521.c) — same as SW2
 *
 * Player sprite: 44×44 Microchip red rounded rectangle with bold white "M" label.
 * Physics driven by a 33 ms lv_timer_t (runs within lv_timer_handler on the UI thread).
 * Timer is deleted via LV_EVENT_DELETE on the screen object.
 *
 * State machine: WAIT → PLAY → OVER → (done flag → demo_manager returns to HUD)
 */

#include "screen_game.h"

#include <zephyr/kernel.h>
#include <zephyr/drivers/gpio.h>
#include <zephyr/sys/printk.h>
#include <lvgl.h>
#include "microchip_logo_img.h"
#include "gy521.h"

/* ── GPIO buttons ─────────────────────────────────────────────────────────── */
static const struct gpio_dt_spec btn_flap =
	GPIO_DT_SPEC_GET(DT_NODELABEL(sw2), gpios);
static const struct gpio_dt_spec btn_enter =
	GPIO_DT_SPEC_GET(DT_ALIAS(sw0), gpios);

/* ── Colours ──────────────────────────────────────────────────────────────── */
#define C_SKY      0x0D1117u
#define C_GROUND   0x3D2B1Fu
#define C_GROUND_H 0x6B4423u
#define C_PIPE     0x3FB950u
#define C_PIPE_CAP 0x2D8A3Au
#define C_MC_RED   0xC0392Bu
#define C_WHITE    0xE6EDF3u
#define C_YELLOW   0xD29922u
#define C_SUBTLE   0x8B949Eu
#define C_OVERLAY  0x161B22u

/* ── Physics constants ────────────────────────────────────────────────────── */
#define GRAVITY     0.50f
#define FLAP_VEL  -11.00f
#define VEL_MAX    14.00f
#define SCROLL_SPD  4.00f   /* initial scroll speed */
#define SPEED_STEP  0.35f   /* added per passed pipe */
#define SPEED_MAX  12.00f   /* speed cap */

/* ── Layout constants ─────────────────────────────────────────────────────── */
#define SCR_W        1280
#define SCR_H         720
#define PLAYER_X      160
#define PLAYER_SZ      44
#define PIPE_W         80
#define PIPE_CAP_H     18
#define GAP_H         280   /* larger gap = easier for kids */
#define PIPE_SPACING  430
#define N_PIPES         3
#define GROUND_Y      672
#define GROUND_H       48
#define GAP_MIN       (GAP_H / 2 + 50)
#define GAP_MAX       (GROUND_Y - GAP_H / 2 - 50)
#define N_STARS        20

/* A flick right after a crash is usually the player still moving, not asking
 * for a restart, so flicks are ignored for this long after GAME_OVER. */
#define OVER_FLICK_HOLDOFF_MS 1000

/* ── Game state ───────────────────────────────────────────────────────────── */
typedef enum { GAME_WAIT, GAME_PLAY, GAME_OVER } game_state_t;

static game_state_t state;
static float        py;         /* player Y (top of sprite) */
static float        vy;         /* player vertical velocity */
static float        pipe_x[N_PIPES];
static int          gap_cy[N_PIPES]; /* centre Y of pipe gap */
static int          score;
static int          best_score;
static float        scroll_spd;   /* current scroll speed, ramps up per pipe */
static bool         scored[N_PIPES]; /* has this pipe been passed */
static int64_t      over_time_ms;    /* when GAME_OVER was entered */
static bool         game_done;       /* signals demo_manager to return */

/* ── Button edge detection ────────────────────────────────────────────────── */
static int prev_flap_state;
static int prev_enter_state;
static bool btn_inited;

static void btn_init_once(void)
{
	if (btn_inited) {
		return;
	}
	if (gpio_is_ready_dt(&btn_flap)) {
		gpio_pin_configure_dt(&btn_flap, GPIO_INPUT);
	}
	if (gpio_is_ready_dt(&btn_enter)) {
		gpio_pin_configure_dt(&btn_enter, GPIO_INPUT);
	}
	/* Seed previous states to current (avoid spurious edge on first call) */
	prev_flap_state  = gpio_pin_get_dt(&btn_flap);
	prev_enter_state = gpio_pin_get_dt(&btn_enter);
	btn_inited = true;
}

static bool flap_edge(void)
{
	int cur = gpio_pin_get_dt(&btn_flap);
	bool edge = (cur == 1) && (prev_flap_state == 0);

	prev_flap_state = cur;
	return edge;
}

static bool enter_edge(void)
{
	int cur = gpio_pin_get_dt(&btn_enter);
	bool edge = (cur == 1) && (prev_enter_state == 0);

	prev_enter_state = cur;
	return edge;
}

/* ── LVGL widget handles ──────────────────────────────────────────────────── */
static lv_obj_t *player_obj;
static lv_obj_t *pipe_top_body[N_PIPES];
static lv_obj_t *pipe_top_cap[N_PIPES];
static lv_obj_t *pipe_bot_body[N_PIPES];
static lv_obj_t *pipe_bot_cap[N_PIPES];
static lv_obj_t *score_lbl;
static lv_obj_t *status_panel;
static lv_obj_t *status_lbl;
static lv_obj_t *sub_lbl;
static lv_timer_t *game_timer;

/* ── Random number (xorshift) ─────────────────────────────────────────────── */
static uint32_t rng_state = 0xDEADBEEFu;

static int rand_gap_cy(void)
{
	rng_state ^= rng_state << 13;
	rng_state ^= rng_state >> 17;
	rng_state ^= rng_state << 5;
	return GAP_MIN + (int)(rng_state % (uint32_t)(GAP_MAX - GAP_MIN));
}

/* ── Pipe helpers ─────────────────────────────────────────────────────────── */
static void pipe_reset(int i, float x)
{
	pipe_x[i]   = x;
	gap_cy[i]   = rand_gap_cy();
	scored[i]   = false;
}

/* Find the pipe furthest to the right */
static float pipes_rightmost_x(void)
{
	float mx = pipe_x[0];

	for (int i = 1; i < N_PIPES; i++) {
		if (pipe_x[i] > mx) {
			mx = pipe_x[i];
		}
	}
	return mx;
}

static void pipe_update_objs(int i)
{
	int ix = (int)pipe_x[i];
	int top_h = gap_cy[i] - GAP_H / 2;
	int bot_y = gap_cy[i] + GAP_H / 2;
	int bot_h = GROUND_Y - bot_y;

	if (top_h < 0) {
		top_h = 0;
	}
	if (bot_h < 0) {
		bot_h = 0;
	}

	/* Top pipe body */
	lv_obj_set_pos(pipe_top_body[i], ix, 0);
	lv_obj_set_size(pipe_top_body[i], PIPE_W, (top_h > PIPE_CAP_H) ?
			top_h - PIPE_CAP_H : 0);

	/* Top pipe cap (wider, at the bottom of the top pipe) */
	lv_obj_set_pos(pipe_top_cap[i], ix - 5, top_h - PIPE_CAP_H);
	lv_obj_set_size(pipe_top_cap[i], PIPE_W + 10,
			(top_h > 0) ? PIPE_CAP_H : 0);

	/* Bottom pipe body */
	lv_obj_set_pos(pipe_bot_body[i], ix, bot_y + PIPE_CAP_H);
	lv_obj_set_size(pipe_bot_body[i], PIPE_W,
			(bot_h > PIPE_CAP_H) ? bot_h - PIPE_CAP_H : 0);

	/* Bottom pipe cap (wider, at the top of the bottom pipe) */
	lv_obj_set_pos(pipe_bot_cap[i], ix - 5, bot_y);
	lv_obj_set_size(pipe_bot_cap[i], PIPE_W + 10,
			(bot_h > 0) ? PIPE_CAP_H : 0);
}

/* ── Collision (AABB) ─────────────────────────────────────────────────────── */
static bool rects_overlap(int ax1, int ay1, int ax2, int ay2,
			   int bx1, int by1, int bx2, int by2)
{
	return ax1 < bx2 && ax2 > bx1 && ay1 < by2 && ay2 > by1;
}

static bool check_collision(void)
{
	int px1 = PLAYER_X + 4;  /* shrink hitbox slightly for fairness */
	int py1 = (int)py + 4;
	int px2 = PLAYER_X + PLAYER_SZ - 4;
	int py2 = (int)py + PLAYER_SZ - 4;

	/* Ground / ceiling */
	if (py2 >= GROUND_Y || py1 <= 0) {
		return true;
	}

	for (int i = 0; i < N_PIPES; i++) {
		int ix = (int)pipe_x[i];
		int top_h = gap_cy[i] - GAP_H / 2;
		int bot_y = gap_cy[i] + GAP_H / 2;

		/* Top pipe */
		if (rects_overlap(px1, py1, px2, py2,
				  ix, 0, ix + PIPE_W, top_h)) {
			return true;
		}
		/* Bottom pipe */
		if (rects_overlap(px1, py1, px2, py2,
				  ix, bot_y, ix + PIPE_W, GROUND_Y)) {
			return true;
		}
	}
	return false;
}

/* ── Status overlay helpers ───────────────────────────────────────────────── */
static void status_show(const char *main_text, const char *sub_text)
{
	lv_obj_clear_flag(status_panel, LV_OBJ_FLAG_HIDDEN);
	lv_label_set_text(status_lbl, main_text);
	lv_label_set_text(sub_lbl, sub_text ? sub_text : "");
}

static void status_hide(void)
{
	lv_obj_add_flag(status_panel, LV_OBJ_FLAG_HIDDEN);
}

static void score_update(void)
{
	char buf[16];

	snprintk(buf, sizeof(buf), "%d", score);
	lv_label_set_text(score_lbl, buf);
}

/* ── Game state transitions ───────────────────────────────────────────────── */
static void game_reset(void)
{
	py    = 300.0f;
	vy    = 0.0f;
	score = 0;
	scroll_spd = SCROLL_SPD;

	for (int i = 0; i < N_PIPES; i++) {
		pipe_reset(i, (float)(SCR_W + i * PIPE_SPACING));
		pipe_update_objs(i);
	}

	score_update();
	lv_obj_set_pos(player_obj, PLAYER_X, (int)py);
}

static void enter_wait(void)
{
	state = GAME_WAIT;
	game_reset();
	status_show("FLAPPY MICROCHIP",
		    "Flick the board or press SW2 to start");
	lv_obj_set_style_text_color(status_lbl, lv_color_hex(C_MC_RED),
				    LV_PART_MAIN);
}

static void enter_play(void)
{
	state = GAME_PLAY;
	status_hide();
}

static void enter_over(void)
{
	char buf[64];

	state = GAME_OVER;
	over_time_ms = k_uptime_get();

	if (score > best_score) {
		best_score = score;
	}

	snprintk(buf, sizeof(buf), "GAME OVER    %d pts", score);
	if (score > 0 && score == best_score) {
		lv_label_set_text(sub_lbl, "New best!");
		lv_obj_set_style_text_color(sub_lbl, lv_color_hex(C_YELLOW),
					    LV_PART_MAIN);
	} else {
		char sub[32];

		snprintk(sub, sizeof(sub), "Best: %d   flick to retry", best_score);
		lv_label_set_text(sub_lbl, sub);
		lv_obj_set_style_text_color(sub_lbl, lv_color_hex(C_SUBTLE),
					    LV_PART_MAIN);
	}
	lv_obj_clear_flag(status_panel, LV_OBJ_FLAG_HIDDEN);
	lv_label_set_text(status_lbl, buf);
	lv_obj_set_style_text_color(status_lbl, lv_color_hex(C_WHITE),
				    LV_PART_MAIN);
}

/* ── 33 ms physics tick (LVGL timer, runs on UI thread) ──────────────────── */
static void game_tick_cb(lv_timer_t *t)
{
	ARG_UNUSED(t);

	btn_init_once();

	/* Always consume the flick so a stale one never fires later. */
	bool flick = gy521_take_flap();
	bool flap  = flap_edge();
	bool enter = enter_edge();

	if (state == GAME_OVER &&
	    k_uptime_get() - over_time_ms < OVER_FLICK_HOLDOFF_MS) {
		flick = false;
	}
	flap = flap || flick;

	switch (state) {
	case GAME_WAIT:
		if (flap) {
			enter_play();
		}
		/* Gentle hover animation while waiting */
		vy += 0.1f;
		py += vy;
		if (py > 320.0f || py < 280.0f) {
			vy = -vy * 0.8f;
			py = CLAMP(py, 280.0f, 320.0f);
		}
		lv_obj_set_pos(player_obj, PLAYER_X, (int)py);
		break;

	case GAME_PLAY:
		/* Physics */
		vy += GRAVITY;
		if (vy > VEL_MAX) {
			vy = VEL_MAX;
		}
		if (flap) {
			vy = FLAP_VEL;
		}
		py += vy;

		lv_obj_set_pos(player_obj, PLAYER_X, (int)py);

		/* Scroll pipes */
		for (int i = 0; i < N_PIPES; i++) {
			pipe_x[i] -= scroll_spd;

			/* Score: player passed pipe centre */
			int centre = (int)pipe_x[i] + PIPE_W / 2;

			if (!scored[i] && centre < PLAYER_X) {
				scored[i] = true;
				score++;
				score_update();
				/* Speed up a little after each pipe, up to the cap */
				scroll_spd += SPEED_STEP;
				if (scroll_spd > SPEED_MAX) {
					scroll_spd = SPEED_MAX;
				}
			}

			/* Respawn pipe that has exited left */
			if (pipe_x[i] + PIPE_W < 0) {
				pipe_reset(i, pipes_rightmost_x() + PIPE_SPACING);
			}

			pipe_update_objs(i);
		}

		/* Collision */
		if (check_collision()) {
			enter_over();
		}
		break;

	case GAME_OVER:
		/* SW2 (flap) restarts the game IN PLACE — same screen, same
		 * timer. No screen reload, so no timer-clobbering race. */
		if (flap) {
			enter_wait();
		}
		break;
	}
}

/* ── Screen delete cleanup ────────────────────────────────────────────────── */
static void game_screen_delete_cb(lv_event_t *e)
{
	ARG_UNUSED(e);

	if (game_timer) {
		lv_timer_delete(game_timer);
		game_timer = NULL;
	}
	/* Null all widget handles so stale pointers are never dereferenced */
	player_obj = NULL;
	score_lbl  = NULL;
	status_panel = NULL;
	status_lbl = NULL;
	sub_lbl    = NULL;
	for (int i = 0; i < N_PIPES; i++) {
		pipe_top_body[i] = NULL;
		pipe_top_cap[i]  = NULL;
		pipe_bot_body[i] = NULL;
		pipe_bot_cap[i]  = NULL;
	}
}

/* ── Screen construction ──────────────────────────────────────────────────── */
lv_obj_t *screen_game_create(void)
{
	game_done        = false;
	if (gpio_is_ready_dt(&btn_flap)) {
		gpio_pin_configure_dt(&btn_flap, GPIO_INPUT);
	}
	if (gpio_is_ready_dt(&btn_enter)) {
		gpio_pin_configure_dt(&btn_enter, GPIO_INPUT);
	}
	prev_flap_state  = gpio_pin_get_dt(&btn_flap);
	prev_enter_state = gpio_pin_get_dt(&btn_enter);
	btn_inited       = true;

	lv_obj_t *scr = lv_obj_create(NULL);

	lv_obj_set_style_bg_color(scr, lv_color_hex(C_SKY), LV_PART_MAIN);
	lv_obj_set_style_bg_opa(scr, LV_OPA_COVER, LV_PART_MAIN);
	lv_obj_set_scrollbar_mode(scr, LV_SCROLLBAR_MODE_OFF);

	/* ── Stars (static decorative dots) ─────────────────────────────── */
	uint32_t star_rng = 0xCAFEBABEu;

	for (int i = 0; i < N_STARS; i++) {
		star_rng ^= star_rng << 13;
		star_rng ^= star_rng >> 17;
		star_rng ^= star_rng << 5;
		int sx = (int)(star_rng % (uint32_t)SCR_W);

		star_rng ^= star_rng << 13;
		star_rng ^= star_rng >> 17;
		star_rng ^= star_rng << 5;
		int sy = (int)(star_rng % (uint32_t)(GROUND_Y - 20));

		lv_obj_t *star = lv_obj_create(scr);
		int sz = (i % 3 == 0) ? 4 : 3;

		lv_obj_set_pos(star, sx, sy);
		lv_obj_set_size(star, sz, sz);
		lv_obj_set_style_bg_color(star, lv_color_white(), LV_PART_MAIN);
		lv_obj_set_style_bg_opa(star, LV_OPA_60, LV_PART_MAIN);
		lv_obj_set_style_border_width(star, 0, LV_PART_MAIN);
		lv_obj_set_style_radius(star, LV_RADIUS_CIRCLE, LV_PART_MAIN);
	}

	/* ── Ground ──────────────────────────────────────────────────────── */
	lv_obj_t *ground = lv_obj_create(scr);

	lv_obj_set_pos(ground, 0, GROUND_Y);
	lv_obj_set_size(ground, SCR_W, GROUND_H);
	lv_obj_set_style_bg_color(ground, lv_color_hex(C_GROUND), LV_PART_MAIN);
	lv_obj_set_style_bg_opa(ground, LV_OPA_COVER, LV_PART_MAIN);
	lv_obj_set_style_border_width(ground, 0, LV_PART_MAIN);
	lv_obj_set_style_radius(ground, 0, LV_PART_MAIN);

	/* Ground highlight strip */
	lv_obj_t *gh = lv_obj_create(scr);

	lv_obj_set_pos(gh, 0, GROUND_Y);
	lv_obj_set_size(gh, SCR_W, 4);
	lv_obj_set_style_bg_color(gh, lv_color_hex(C_GROUND_H), LV_PART_MAIN);
	lv_obj_set_style_bg_opa(gh, LV_OPA_COVER, LV_PART_MAIN);
	lv_obj_set_style_border_width(gh, 0, LV_PART_MAIN);
	lv_obj_set_style_radius(gh, 0, LV_PART_MAIN);

	/* ── Pipes (pre-created, positioned in game_reset) ───────────────── */
	for (int i = 0; i < N_PIPES; i++) {
		/* Top body */
		pipe_top_body[i] = lv_obj_create(scr);
		lv_obj_set_style_bg_color(pipe_top_body[i], lv_color_hex(C_PIPE),
					   LV_PART_MAIN);
		lv_obj_set_style_bg_opa(pipe_top_body[i], LV_OPA_COVER, LV_PART_MAIN);
		lv_obj_set_style_border_width(pipe_top_body[i], 0, LV_PART_MAIN);
		lv_obj_set_style_radius(pipe_top_body[i], 0, LV_PART_MAIN);

		/* Top cap */
		pipe_top_cap[i] = lv_obj_create(scr);
		lv_obj_set_style_bg_color(pipe_top_cap[i], lv_color_hex(C_PIPE_CAP),
					   LV_PART_MAIN);
		lv_obj_set_style_bg_opa(pipe_top_cap[i], LV_OPA_COVER, LV_PART_MAIN);
		lv_obj_set_style_border_width(pipe_top_cap[i], 0, LV_PART_MAIN);
		lv_obj_set_style_radius(pipe_top_cap[i], 3, LV_PART_MAIN);

		/* Bottom body */
		pipe_bot_body[i] = lv_obj_create(scr);
		lv_obj_set_style_bg_color(pipe_bot_body[i], lv_color_hex(C_PIPE),
					   LV_PART_MAIN);
		lv_obj_set_style_bg_opa(pipe_bot_body[i], LV_OPA_COVER, LV_PART_MAIN);
		lv_obj_set_style_border_width(pipe_bot_body[i], 0, LV_PART_MAIN);
		lv_obj_set_style_radius(pipe_bot_body[i], 0, LV_PART_MAIN);

		/* Bottom cap */
		pipe_bot_cap[i] = lv_obj_create(scr);
		lv_obj_set_style_bg_color(pipe_bot_cap[i], lv_color_hex(C_PIPE_CAP),
					   LV_PART_MAIN);
		lv_obj_set_style_bg_opa(pipe_bot_cap[i], LV_OPA_COVER, LV_PART_MAIN);
		lv_obj_set_style_border_width(pipe_bot_cap[i], 0, LV_PART_MAIN);
		lv_obj_set_style_radius(pipe_bot_cap[i], 3, LV_PART_MAIN);
	}

	/* ── Player: Microchip logo (red rounded rect + white M) ─────────── */
	/* ── Player: Microchip logo (RGB565, rounded corners) ───────────── */
	player_obj = lv_image_create(scr);
	lv_image_set_src(player_obj, &microchip_logo_img);
	lv_obj_set_style_bg_opa(player_obj, LV_OPA_TRANSP, 0);
	lv_obj_set_style_border_width(player_obj, 0, 0);
	lv_obj_set_style_pad_all(player_obj, 0, 0);

	/* ── Score label ─────────────────────────────────────────────────── */
	score_lbl = lv_label_create(scr);
	lv_label_set_text(score_lbl, "0");
	lv_obj_set_style_text_font(score_lbl, &lv_font_montserrat_48, LV_PART_MAIN);
	lv_obj_set_style_text_color(score_lbl, lv_color_white(), LV_PART_MAIN);
	lv_obj_align(score_lbl, LV_ALIGN_TOP_MID, 0, 12);

	/* ── Status overlay (hidden during play) ─────────────────────────── */
	status_panel = lv_obj_create(scr);
	lv_obj_set_size(status_panel, 700, 150);
	lv_obj_align(status_panel, LV_ALIGN_CENTER, 0, 0);
	lv_obj_set_style_bg_color(status_panel, lv_color_hex(C_OVERLAY), LV_PART_MAIN);
	lv_obj_set_style_bg_opa(status_panel, LV_OPA_80, LV_PART_MAIN);
	lv_obj_set_style_border_color(status_panel, lv_color_hex(C_MC_RED),
				       LV_PART_MAIN);
	lv_obj_set_style_border_width(status_panel, 2, LV_PART_MAIN);
	lv_obj_set_style_radius(status_panel, 10, LV_PART_MAIN);
	lv_obj_set_scrollbar_mode(status_panel, LV_SCROLLBAR_MODE_OFF);

	status_lbl = lv_label_create(status_panel);
	lv_label_set_text(status_lbl, "");
	lv_obj_set_style_text_font(status_lbl, &lv_font_montserrat_32, LV_PART_MAIN);
	lv_obj_set_style_text_color(status_lbl, lv_color_white(), LV_PART_MAIN);
	lv_obj_align(status_lbl, LV_ALIGN_CENTER, 0, -22);

	sub_lbl = lv_label_create(status_panel);
	lv_label_set_text(sub_lbl, "");
	lv_obj_set_style_text_font(sub_lbl, &lv_font_montserrat_20, LV_PART_MAIN);
	lv_obj_set_style_text_color(sub_lbl, lv_color_hex(C_SUBTLE), LV_PART_MAIN);
	lv_obj_align(sub_lbl, LV_ALIGN_CENTER, 0, 20);

	/* ── Initialise game to WAIT state ───────────────────────────────── */
	enter_wait();

	/* ── Game timer: 33 ms physics loop ─────────────────────────────── */
	game_timer = lv_timer_create(game_tick_cb, 33, NULL);

	/* ── Cleanup hook: delete timer when screen is freed ─────────────── */
	lv_obj_add_event_cb(scr, game_screen_delete_cb, LV_EVENT_DELETE, NULL);

	return scr;
}

void screen_game_update(void)
{
	/* Physics is driven by game_timer; nothing to do at 1 Hz. */
}

bool screen_game_is_done(void)
{
	if (game_done) {
		game_done = false;
		return true;
	}
	return false;
}
```

## src/screen_widgets.h
```c
/* SPDX-License-Identifier: Apache-2.0 */
#ifndef SRC_SCREEN_WIDGETS_H
#define SRC_SCREEN_WIDGETS_H

#include <lvgl.h>

lv_obj_t *screen_widgets_create(void);
void      screen_widgets_update(void);  /* no-op — all driven by lv_anim_t */

#endif /* SRC_SCREEN_WIDGETS_H */
```
